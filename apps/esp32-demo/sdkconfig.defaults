## benchmarks/esp32/lvgl-app/main/Kconfig.projbuild
```kconfig
menu "LVGL bench"

config BENCH_TEXT_EVERY_FRAME
    bool "A line of text changes every frame"
    default n
    help
        The seconds line shows a number that counts up every frame, as a
        clock or a sensor reading does, instead of the seconds. The Cranpose
        demo's text-drawn and text-composed features show the same line.

config BENCH_DASHBOARD
    bool "The dashboard in place of the demo's screen"
    default n
    help
        The dashboard of crates/cranpose/tests/support/dashboard.rs, which
        changes most of the display every frame. The Cranpose demo's
        dashboard feature and the Slint benchmark show the same screen.

endmenu
```

## benchmarks/esp32/perfstats/Kconfig
```kconfig
menu "perfstats"

config PERFSTATS_WINDOW_MS
    int "Window length in milliseconds"
    default 5000
    help
        How long each window counts one pair of events. Board A/Bs that show
        the demo's screens in turn use 1000, so each screen's time holds
        several windows.

endmenu
```

## crates/cranpose-platform/esp-idf/components/cranpose_hot_code/Kconfig
```kconfig
menu "Cranpose"

    config CRANPOSE_HOT_CODE_IN_IRAM
        bool "Run the framework's per-frame code from IRAM"
        default y
        help
            Links the framework functions that a frame runs most into IRAM,
            where the CPU fetches them without waiting for the flash or PSRAM
            cache. A frame of the demo then takes about half the time. The
            code takes 128 KB of internal RAM on the ESP32-S3, where IRAM and
            the heap share it, and 64 KB of the classic ESP32's IRAM, which
            its heap only lends to 32-bit allocations. Turn it off for an
            application that needs that memory more.

endmenu
```

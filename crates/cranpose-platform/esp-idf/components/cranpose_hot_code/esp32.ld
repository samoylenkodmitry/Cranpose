/* Generated by scripts/esp32/hot_code.py from 3 profiles of apps/esp32-demo on the E32R35T.
 * 121 patterns, 64 KB, took 53% of the samples in Rust code.
 * See README.md beside this file. */
SECTIONS
{
  .iram0.cranpose :
  {
    . = ALIGN(4);
    *(.literal._RINCNCNvM*NtCs*_18cranpose_animation9animationNt*18InfiniteTransition3run00lE* .text._RINCNCNvM*NtCs*_18cranpose_animation9animationNt*18InfiniteTransition3run00lE*)
    *(.literal._RINvM*Cs*_22cranpose_render_pixelsNt*14PixelsRenderer20draw_picture_area_asNtNtCs*_22cranpose_render_common6rgb5658Rgb565BeE* .text._RINvM*Cs*_22cranpose_render_pixelsNt*14PixelsRenderer20draw_picture_area_asNtNtCs*_22cranpose_render_common6rgb5658Rgb565BeE*)
    *(.literal._RINvM*NtCs*_13cranpose_core23snapshot_state_observerNt*26SnapshotStateObserverInner16find_scope_entryNtNtNtCs*_11cranpose_ui12render_state16draw_observation20DrawObservationScopeE* .text._RINvM*NtCs*_13cranpose_core23snapshot_state_observerNt*26SnapshotStateObserverInner16find_scope_entryNtNtNtCs*_11cranpose_ui12render_state16draw_observation20DrawObservationScopeE*)
    *(.literal._RINvM*NtCs*_22cranpose_render_pixels5sceneNt*11RasterScene9push_itemNt*9DrawShapeE* .text._RINvM*NtCs*_22cranpose_render_pixels5sceneNt*11RasterScene9push_itemNt*9DrawShapeE*)
    *(.literal._RINvM*NtCs*_4core3anyNt*6TypeId2ofNtNtCs*_11cranpose_ui18text_modifier_node19TextModifierElementE* .text._RINvM*NtCs*_4core3anyNt*6TypeId2ofNtNtCs*_11cranpose_ui18text_modifier_node19TextModifierElementE*)
    *(.literal._RINvM*NtCs*_9hashbrown3mapINt*7HashMapNtCs*_13cranpose_core6NodeIdNtCs*_22cranpose_render_common10NodeUpdateINtNtCs*_4core4hash18BuildHasherDefaultNtNtNt*11collections9word_hash10WordHasherEE6remove*E* .text._RINvM*NtCs*_9hashbrown3mapINt*7HashMapNtCs*_13cranpose_core6NodeIdNtCs*_22cranpose_render_common10NodeUpdateINtNtCs*_4core4hash18BuildHasherDefaultNtNtNt*11collections9word_hash10WordHasherEE6remove*E*)
    *(.literal._RINvM*NtNtCs*_13cranpose_core11collections9pass_agedINt*13PassAgedCacheNtNtNtCs*_11cranpose_ui4text8text_key7TextKeyINtCs*_8smallvec8SmallVecAINtNtCs*_5alloc2rc2RcNtNt*20prepared_text_layout18PreparedTextLayoutEj2_EE7get_mut*E* .text._RINvM*NtNtCs*_13cranpose_core11collections9pass_agedINt*13PassAgedCacheNtNtNtCs*_11cranpose_ui4text8text_key7TextKeyINtCs*_8smallvec8SmallVecAINtNtCs*_5alloc2rc2RcNtNt*20prepared_text_layout18PreparedTextLayoutEj2_EE7get_mut*E*)
    *(.literal._RINvM*NtNtCs*_13cranpose_core7runtime11state_arenaNt*10StateArena9get_typedfE* .text._RINvM*NtNtCs*_13cranpose_core7runtime11state_arenaNt*10StateArena9get_typedfE*)
    *(.literal._RINvNtCs*_12futures_task5waker12drop_arc_rawNtNtCs*_13cranpose_core7runtime16RuntimeTaskWakerE* .text._RINvNtCs*_12futures_task5waker12drop_arc_rawNtNtCs*_13cranpose_core7runtime16RuntimeTaskWakerE*)
    *(.literal._RINvNtCs*_12futures_task5waker12wake_arc_rawNtNtCs*_13cranpose_core7runtime16RuntimeTaskWakerE* .text._RINvNtCs*_12futures_task5waker12wake_arc_rawNtNtCs*_13cranpose_core7runtime16RuntimeTaskWakerE*)
    *(.literal._RINvNtCs*_12futures_task5waker13clone_arc_rawNtNtCs*_13cranpose_core7runtime16RuntimeTaskWakerE* .text._RINvNtCs*_12futures_task5waker13clone_arc_rawNtNtCs*_13cranpose_core7runtime16RuntimeTaskWakerE*)
    *(.literal._RINvNtCs*_18cranpose_app_shell7surface22route_batch_by_surfaceNtCs*_22cranpose_render_pixels14PixelsRendererINtNtNtNtCs*_4core4iter8adapters6copied6CopiedINtNtNt*5slice4iter4IterNtCs*_13cranpose_core6NodeIdEEE* .text._RINvNtCs*_18cranpose_app_shell7surface22route_batch_by_surfaceNtCs*_22cranpose_render_pixels14PixelsRendererINtNtNtNtCs*_4core4iter8adapters6copied6CopiedINtNtNt*5slice4iter4IterNtCs*_13cranpose_core6NodeIdEEE*)
    *(.literal._RINvNtCs*_22cranpose_render_common11text_canvas21draw_mask_glyph_solidNtNt*6rgb5658Rgb565BeNt*9OverBlendE* .text._RINvNtCs*_22cranpose_render_common11text_canvas21draw_mask_glyph_solidNtNt*6rgb5658Rgb565BeNt*9OverBlendE*)
    *(.literal._RINvNtCs*_4core3ptr9drop_glueINtCs*_8smallvec8SmallVecAINtNtCs*_5alloc5boxed3BoxDNtNtCs*_13cranpose_core5state11RecordValueEL_Ej2_EE* .text._RINvNtCs*_4core3ptr9drop_glueINtCs*_8smallvec8SmallVecAINtNtCs*_5alloc5boxed3BoxDNtNtCs*_13cranpose_core5state11RecordValueEL_Ej2_EE*)
    *(.literal._RINvNtCs*_4core3ptr9drop_glueNtNtCs*_13cranpose_core11frame_clock9NextFrameE* .text._RINvNtCs*_4core3ptr9drop_glueNtNtCs*_13cranpose_core11frame_clock9NextFrameE*)
    *(.literal._RINvNtCs*_4core3ptr9drop_glueNtNtCs*_13cranpose_core11snapshot_v211AnySnapshotE* .text._RINvNtCs*_4core3ptr9drop_glueNtNtCs*_13cranpose_core11snapshot_v211AnySnapshotE*)
    *(.literal._RINvNtCs*_4core3ptr9drop_glueNtNtCs*_13cranpose_text11text_layout10TextLayoutE* .text._RINvNtCs*_4core3ptr9drop_glueNtNtCs*_13cranpose_text11text_layout10TextLayoutE*)
    *(.literal._RINvNtCs*_4core3ptr9drop_glueNtNtCs*_20cranpose_ui_graphics5brush5BrushE* .text._RINvNtCs*_4core3ptr9drop_glueNtNtCs*_20cranpose_ui_graphics5brush5BrushE*)
    *(.literal._RINvNtCs*_4core3ptr9drop_glueNtNtNtCs*_13cranpose_core11snapshot_v214snapshot_state13SnapshotStateE* .text._RINvNtCs*_4core3ptr9drop_glueNtNtNtCs*_13cranpose_core11snapshot_v214snapshot_state13SnapshotStateE*)
    *(.literal._RNCINvM*NtCs*_13cranpose_core23snapshot_state_observerNt*26SnapshotStateObserverInner3newNCNvNtNtCs*_11cranpose_ui12render_state16draw_observation17new_draw_observer0Es_0* .text._RNCINvM*NtCs*_13cranpose_core23snapshot_state_observerNt*26SnapshotStateObserverInner3newNCNvNtNtCs*_11cranpose_ui12render_state16draw_observation17new_draw_observer0Es_0*)
    *(.literal._RNCINvM*NtNtCs*_13cranpose_core7runtime11state_arenaNt*10StateArena9get_typedyE0* .text._RNCINvM*NtNtCs*_13cranpose_core7runtime11state_arenaNt*10StateArena9get_typedyE0*)
    *(.literal._RNCINvNtNtCs*_22cranpose_render_common13scene_builder11inline_leaf15read_child_databNCNv*19update_dirty_inline0E0* .text._RNCINvNtNtCs*_22cranpose_render_common13scene_builder11inline_leaf15read_child_databNCNv*19update_dirty_inline0E0*)
    *(.literal._RNCNCINvM*NtCs*_13cranpose_core23snapshot_state_observerNt*26SnapshotStateObserverInner13observe_readsNtNtNtCs*_11cranpose_ui12render_state16draw_observation20DrawObservationScopeNtNtCs*_20cranpose_ui_graphics8geometry13GraphicsLayerNCINv*18observe_draw_reads*NCNCNCNvM*Nt*14modifier_nodesNt*17GraphicsLayerNode14layer_resolver000Es_0*E00* .text._RNCNCINvM*NtCs*_13cranpose_core23snapshot_state_observerNt*26SnapshotStateObserverInner13observe_readsNtNtNtCs*_11cranpose_ui12render_state16draw_observation20DrawObservationScopeNtNtCs*_20cranpose_ui_graphics8geometry13GraphicsLayerNCINv*18observe_draw_reads*NCNCNCNvM*Nt*14modifier_nodesNt*17GraphicsLayerNode14layer_resolver000Es_0*E00*)
    *(.literal._RNCNvM*NtCs*_13cranpose_core23snapshot_state_observerNt*26SnapshotStateObserverInner5start0* .text._RNCNvM*NtCs*_13cranpose_core23snapshot_state_observerNt*26SnapshotStateObserverInner5start0*)
    *(.literal._RNCNvM*NtNtCs*_22cranpose_render_pixels4draw5reachNtNt*5scene11RasterScene13covers_window0* .text._RNCNvM*NtNtCs*_22cranpose_render_pixels4draw5reachNtNt*5scene11RasterScene13covers_window0*)
    *(.literal._RNCNvNtCs*_11cranpose_ui14modifier_nodes20observe_draw_command0* .text._RNCNvNtCs*_11cranpose_ui14modifier_nodes20observe_draw_command0*)
    *(.literal._RNSNvYNCNCINvM*NtCs*_13cranpose_core23snapshot_state_observerNt*26SnapshotStateObserverInner13observe_readsNtNtNtCs*_11cranpose_ui12render_state16draw_observation20DrawObservationScopeNtNtCs*_20cranpose_ui_graphics8geometry13GraphicsLayerNCINv*18observe_draw_reads*NCNCNCNvM*Nt*14modifier_nodesNt*17GraphicsLayerNode14layer_resolver000Es_0*E00INtNtNtCs*_4core3ops8function6FnOnceTRDNtNt*3any3AnyEL_EE9call_once6vtable* .text._RNSNvYNCNCINvM*NtCs*_13cranpose_core23snapshot_state_observerNt*26SnapshotStateObserverInner13observe_readsNtNtNtCs*_11cranpose_ui12render_state16draw_observation20DrawObservationScopeNtNtCs*_20cranpose_ui_graphics8geometry13GraphicsLayerNCINv*18observe_draw_reads*NCNCNCNvM*Nt*14modifier_nodesNt*17GraphicsLayerNode14layer_resolver000Es_0*E00INtNtNtCs*_4core3ops8function6FnOnceTRDNtNt*3any3AnyEL_EE9call_once6vtable*)
    *(.literal._RNSNvYNCNvM*NtCs*_13cranpose_core23snapshot_state_observerNt*26SnapshotStateObserverInner5start0INtNtNtCs*_4core3ops8function6FnOnceTRSINtNtCs*_5alloc2rc2RcDNtNt*5state11StateObjectEL_ENtNt*15snapshot_id_set10SnapshotIdEE9call_once6vtable* .text._RNSNvYNCNvM*NtCs*_13cranpose_core23snapshot_state_observerNt*26SnapshotStateObserverInner5start0INtNtNtCs*_4core3ops8function6FnOnceTRSINtNtCs*_5alloc2rc2RcDNtNt*5state11StateObjectEL_ENtNt*15snapshot_id_set10SnapshotIdEE9call_once6vtable*)
    *(.literal._RNvM*Cs*_18cranpose_app_shellINt*8AppShellNtCs*_22cranpose_render_pixels14PixelsRendererE22update_with_frame_time* .text._RNvM*Cs*_18cranpose_app_shellINt*8AppShellNtCs*_22cranpose_render_pixels14PixelsRendererE22update_with_frame_time*)
    *(.literal._RNvM*NtCs*_11cranpose_ui11modal_nodesNt*10ModalNodes12set_counting* .text._RNvM*NtCs*_11cranpose_ui11modal_nodesNt*10ModalNodes12set_counting*)
    *(.literal._RNvM*NtCs*_11cranpose_ui12render_stateNt*10AppContext11enter_scope* .text._RNvM*NtCs*_11cranpose_ui12render_stateNt*10AppContext11enter_scope*)
    *(.literal._RNvM*NtCs*_13cranpose_core13bubble_passesNt*12BubblePasses4note* .text._RNvM*NtCs*_13cranpose_core13bubble_passesNt*12BubblePasses4note*)
    *(.literal._RNvM*NtCs*_13cranpose_core15recompose_scopeNt*14RecomposeScope13run_recompose* .text._RNvM*NtCs*_13cranpose_core15recompose_scopeNt*14RecomposeScope13run_recompose*)
    *(.literal._RNvM*NtCs*_13cranpose_core23snapshot_state_observerNt*20ReadObservationStack4push* .text._RNvM*NtCs*_13cranpose_core23snapshot_state_observerNt*20ReadObservationStack4push*)
    *(.literal._RNvM*NtCs*_13cranpose_core23snapshot_state_observerNt*26SnapshotStateObserverInner14notify_pending* .text._RNvM*NtCs*_13cranpose_core23snapshot_state_observerNt*26SnapshotStateObserverInner14notify_pending*)
    *(.literal._RNvM*NtCs*_13cranpose_core5stateINt*12MutableStatefE7replace* .text._RNvM*NtCs*_13cranpose_core5stateINt*12MutableStatefE7replace*)
    *(.literal._RNvM*NtCs*_13cranpose_core5stateNt*11WriteTarget19finish_global_write* .text._RNvM*NtCs*_13cranpose_core5stateNt*11WriteTarget19finish_global_write*)
    *(.literal._RNvM*NtCs*_13cranpose_core7runtimeNt*12RuntimeInner15enqueue_ui_task* .text._RNvM*NtCs*_13cranpose_core7runtimeNt*12RuntimeInner15enqueue_ui_task*)
    *(.literal._RNvM*NtCs*_13cranpose_core7runtimeNt*12RuntimeInner15run_local_tasks* .text._RNvM*NtCs*_13cranpose_core7runtimeNt*12RuntimeInner15run_local_tasks*)
    *(.literal._RNvM*NtCs*_13cranpose_core7runtimeNt*12RuntimeInner16poll_async_tasks* .text._RNvM*NtCs*_13cranpose_core7runtimeNt*12RuntimeInner16poll_async_tasks*)
    *(.literal._RNvM*NtCs*_13cranpose_core7runtimeNt*12RuntimeInner23register_frame_callback* .text._RNvM*NtCs*_13cranpose_core7runtimeNt*12RuntimeInner23register_frame_callback*)
    *(.literal._RNvM*NtCs*_13cranpose_core7runtimeNt*12RuntimeInner25clear_needs_frame_if_idle* .text._RNvM*NtCs*_13cranpose_core7runtimeNt*12RuntimeInner25clear_needs_frame_if_idle*)
    *(.literal._RNvM*NtCs*_13cranpose_core7runtimeNt*7Runtime14has_pending_ui* .text._RNvM*NtCs*_13cranpose_core7runtimeNt*7Runtime14has_pending_ui*)
    *(.literal._RNvM*NtCs*_18cranpose_app_shell11shell_frameNt*11SurfaceDirt8classify* .text._RNvM*NtCs*_18cranpose_app_shell11shell_frameNt*11SurfaceDirt8classify*)
    *(.literal._RNvM*NtCs*_20cranpose_ui_graphics13shape_recordsNt*12ShapeRecords4push* .text._RNvM*NtCs*_20cranpose_ui_graphics13shape_recordsNt*12ShapeRecords4push*)
    *(.literal._RNvM*NtCs*_20cranpose_ui_graphics6recordNt*13ShapeRecorder11push_shaded* .text._RNvM*NtCs*_20cranpose_ui_graphics6recordNt*13ShapeRecorder11push_shaded*)
    *(.literal._RNvM*NtCs*_20cranpose_ui_graphics6recordNt*13ShapeRecorder5clear* .text._RNvM*NtCs*_20cranpose_ui_graphics6recordNt*13ShapeRecorder5clear*)
    *(.literal._RNvM*NtCs*_20cranpose_ui_graphics9transformNt*19ProjectiveTransform15bounds_for_rect* .text._RNvM*NtCs*_20cranpose_ui_graphics9transformNt*19ProjectiveTransform15bounds_for_rect*)
    *(.literal._RNvM*NtCs*_22cranpose_render_common14primitive_emitNt*14ShapePlacement4fill* .text._RNvM*NtCs*_22cranpose_render_common14primitive_emitNt*14ShapePlacement4fill*)
    *(.literal._RNvM*NtCs*_22cranpose_render_pixels5sceneNt*11RasterScene5clear* .text._RNvM*NtCs*_22cranpose_render_pixels5sceneNt*11RasterScene5clear*)
    *(.literal._RNvM*NtCs*_22cranpose_render_pixels5sceneNt*7Subtree9of_record* .text._RNvM*NtCs*_22cranpose_render_pixels5sceneNt*7Subtree9of_record*)
    *(.literal._RNvM*NtCs*_22cranpose_render_pixels5sceneNt*8TextDraw11glyph_reach* .text._RNvM*NtCs*_22cranpose_render_pixels5sceneNt*8TextDraw11glyph_reach*)
    *(.literal._RNvM*NtCs*_5alloc4syncINt*3ArcDG0_INtNtNtCs*_4core3ops8function2FnTRL1_I*DNtNtCs*_17cranpose_services12image_picker11ImagePickerEL_ERL0_*EEp6OutputbNtNt*6marker4SendNt*4SyncEL_E9drop_slow* .text._RNvM*NtCs*_5alloc4syncINt*3ArcDG0_INtNtNtCs*_4core3ops8function2FnTRL1_I*DNtNtCs*_17cranpose_services12image_picker11ImagePickerEL_ERL0_*EEp6OutputbNtNt*6marker4SendNt*4SyncEL_E9drop_slow*)
    *(.literal._RNvM*NtCs*_5alloc4syncINt*3ArcSNtNtCs*_13cranpose_text11laid_glyphs11PackedGlyphE9drop_slow* .text._RNvM*NtCs*_5alloc4syncINt*3ArcSNtNtCs*_13cranpose_text11laid_glyphs11PackedGlyphE9drop_slow*)
    *(.literal._RNvM*NtCs*_5alloc7raw_vecINt*6RawVecNtNtCs*_18cranpose_app_shell9inspector16InspectorControlE8grow_one* .text._RNvM*NtCs*_5alloc7raw_vecINt*6RawVecNtNtCs*_18cranpose_app_shell9inspector16InspectorControlE8grow_one*)
    *(.literal._RNvM*NtCs*_5alloc7raw_vecINt*6RawVecNtNtNtCs*_11cranpose_ui4text12layout_cache11DrawnLayoutE8grow_one* .text._RNvM*NtCs*_5alloc7raw_vecINt*6RawVecNtNtNtCs*_11cranpose_ui4text12layout_cache11DrawnLayoutE8grow_one*)
    *(.literal._RNvM*NtNtCs*_11cranpose_ui12render_state14dirty_node_setNt*12DirtyNodeSet21take_dirty_nodes_into* .text._RNvM*NtNtCs*_11cranpose_ui12render_state14dirty_node_setNt*12DirtyNodeSet21take_dirty_nodes_into*)
    *(.literal._RNvM*NtNtCs*_11cranpose_ui7widgets5popupNt*21HostedPopupRegistries16dismissable_open* .text._RNvM*NtNtCs*_11cranpose_ui7widgets5popupNt*21HostedPopupRegistries16dismissable_open*)
    *(.literal._RNvM*NtNtCs*_11cranpose_ui8modifier16coordinator_rectNt*15CoordinatorRect11placed_rect* .text._RNvM*NtNtCs*_11cranpose_ui8modifier16coordinator_rectNt*15CoordinatorRect11placed_rect*)
    *(.literal._RNvM*NtNtCs*_13cranpose_core11snapshot_v211transparentNt*34TransparentObserverMutableSnapshot11new_reusing* .text._RNvM*NtNtCs*_13cranpose_core11snapshot_v211transparentNt*34TransparentObserverMutableSnapshot11new_reusing*)
    *(.literal._RNvM*NtNtCs*_13cranpose_core5state12record_chainNt*11RecordChain17overwritable_head* .text._RNvM*NtNtCs*_13cranpose_core5state12record_chainNt*11RecordChain17overwritable_head*)
    *(.literal._RNvM*NtNtCs*_13cranpose_core5state12record_chainNt*11RecordChain4used* .text._RNvM*NtNtCs*_13cranpose_core5state12record_chainNt*11RecordChain4used*)
    *(.literal._RNvM*NtNtCs*_13cranpose_core5state12record_chainNt*11RecordChain8readable* .text._RNvM*NtNtCs*_13cranpose_core5state12record_chainNt*11RecordChain8readable*)
    *(.literal._RNvM*NtNtCs*_13cranpose_core7runtime7ui_taskNt*13RuntimeHandle22enqueue_shared_ui_task* .text._RNvM*NtNtCs*_13cranpose_core7runtime7ui_taskNt*13RuntimeHandle22enqueue_shared_ui_task*)
    *(.literal._RNvM*NtNtCs*_18cranpose_app_shell7surface9list_roomNt*8ListRoom4trim* .text._RNvM*NtNtCs*_18cranpose_app_shell7surface9list_roomNt*8ListRoom4trim*)
    *(.literal._RNvM*NtNtCs*_20cranpose_ui_graphics6record11shape_spansNt*13ShapeRecorder17truncate_segments* .text._RNvM*NtNtCs*_20cranpose_ui_graphics6record11shape_spansNt*13ShapeRecorder17truncate_segments*)
    *(.literal._RNvM*NtNtCs*_22cranpose_render_common11scene_store5storeNt*10SceneStore12begin_update* .text._RNvM*NtNtCs*_22cranpose_render_common11scene_store5storeNt*10SceneStore12begin_update*)
    *(.literal._RNvM*NtNtCs*_22cranpose_render_common11scene_store5storeNt*10SceneStore18raise_subtree_revs* .text._RNvM*NtNtCs*_22cranpose_render_common11scene_store5storeNt*10SceneStore18raise_subtree_revs*)
    *(.literal._RNvM*NtNtCs*_22cranpose_render_common11scene_store5storeNt*10SceneStore19note_content_change* .text._RNvM*NtNtCs*_22cranpose_render_common11scene_store5storeNt*10SceneStore19note_content_change*)
    *(.literal._RNvM*NtNtCs*_22cranpose_render_common11scene_store5storeNt*10SceneStore7add_run* .text._RNvM*NtNtCs*_22cranpose_render_common11scene_store5storeNt*10SceneStore7add_run*)
    *(.literal._RNvM*NtNtCs*_22cranpose_render_pixels4draw8row_runsNt*11RoundedFill3run* .text._RNvM*NtNtCs*_22cranpose_render_pixels4draw8row_runsNt*11RoundedFill3run*)
    *(.literal._RNvM*NtNtCs*_22cranpose_render_pixels8pipeline8in_placeNt*6Repush5visit* .text._RNvM*NtNtCs*_22cranpose_render_pixels8pipeline8in_placeNt*6Repush5visit*)
    *(.literal._RNvM*NtNtCs*_4core4cell4lazyINt*8LazyCellINtNtCs*_5alloc2rc2RcDNtNtCs*_13cranpose_core23snapshot_state_observer20ScopeChangedCallbackp6OutputuEL_ENCINvM**Nt*26SnapshotStateObserverInner13observe_readsNtNtNtCs*_11cranpose_ui12render_state16draw_observation20DrawObservationScopeuNCINv*18observe_draw_readsuNCNCNvNt*14modifier_nodes20observe_draw_command00Es_0*E0E11really_init* .text._RNvM*NtNtCs*_4core4cell4lazyINt*8LazyCellINtNtCs*_5alloc2rc2RcDNtNtCs*_13cranpose_core23snapshot_state_observer20ScopeChangedCallbackp6OutputuEL_ENCINvM**Nt*26SnapshotStateObserverInner13observe_readsNtNtNtCs*_11cranpose_ui12render_state16draw_observation20DrawObservationScopeuNCINv*18observe_draw_readsuNCNCNvNt*14modifier_nodes20observe_draw_command00Es_0*E0E11really_init*)
    *(.literal._RNvNtCs*_11cranpose_ui12render_state17app_context_by_id* .text._RNvNtCs*_11cranpose_ui12render_state17app_context_by_id*)
    *(.literal._RNvNtCs*_11cranpose_ui12render_state19current_app_context* .text._RNvNtCs*_11cranpose_ui12render_state19current_app_context*)
    *(.literal._RNvNtCs*_11cranpose_ui15memory_headroom23current_memory_headroom* .text._RNvNtCs*_11cranpose_ui15memory_headroom23current_memory_headroom*)
    *(.literal._RNvNtCs*_13cranpose_core11concurrency19next_alarm_deadline* .text._RNvNtCs*_13cranpose_core11concurrency19next_alarm_deadline*)
    *(.literal._RNvNtCs*_13cranpose_core11snapshot_v216current_snapshot* .text._RNvNtCs*_13cranpose_core11snapshot_v216current_snapshot*)
    *(.literal._RNvNtCs*_13cranpose_core11snapshot_v222notify_apply_observers* .text._RNvNtCs*_13cranpose_core11snapshot_v222notify_apply_observers*)
    *(.literal._RNvNtCs*_13cranpose_core11snapshot_v227current_snapshot_reads_into* .text._RNvNtCs*_13cranpose_core11snapshot_v227current_snapshot_reads_into*)
    *(.literal._RNvNtCs*_13cranpose_core11snapshot_v250take_transparent_observer_mutable_snapshot_reusing* .text._RNvNtCs*_13cranpose_core11snapshot_v250take_transparent_observer_mutable_snapshot_reusing*)
    *(.literal._RNvNtCs*_20cranpose_ui_graphics15layer_transform19apply_layer_to_quad* .text._RNvNtCs*_20cranpose_ui_graphics15layer_transform19apply_layer_to_quad*)
    *(.literal._RNvNtCs*_22cranpose_render_common12style_shared20apply_paint_to_color* .text._RNvNtCs*_22cranpose_render_common12style_shared20apply_paint_to_color*)
    *(.literal._RNvNtCs*_22cranpose_render_common14primitive_emit23round_rect_shape_params* .text._RNvNtCs*_22cranpose_render_common14primitive_emit23round_rect_shape_params*)
    *(.literal._RNvNtCs*_22cranpose_render_pixels4draw18opaque_solid_bytes* .text._RNvNtCs*_22cranpose_render_pixels4draw18opaque_solid_bytes*)
    *(.literal._RNvNtCs*_22cranpose_render_pixels4draw19clip_rect_to_window* .text._RNvNtCs*_22cranpose_render_pixels4draw19clip_rect_to_window*)
    *(.literal._RNvNtCs*_22cranpose_render_pixels6damage16add_changed_pair* .text._RNvNtCs*_22cranpose_render_pixels6damage16add_changed_pair*)
    *(.literal._RNvNtCs*_22cranpose_render_pixels6damage8add_area* .text._RNvNtCs*_22cranpose_render_pixels6damage8add_area*)
    *(.literal._RNvNtCs*_22cranpose_render_pixels8pipeline11scene_light* .text._RNvNtCs*_22cranpose_render_pixels8pipeline11scene_light*)
    *(.literal._RNvNtCs*_22cranpose_render_pixels8pipeline25populate_draws_from_graph* .text._RNvNtCs*_22cranpose_render_pixels8pipeline25populate_draws_from_graph*)
    *(.literal._RNvNtNtCs*_13cranpose_core5state15readable_record35readable_record_for_active_snapshot* .text._RNvNtNtCs*_13cranpose_core5state15readable_record35readable_record_for_active_snapshot*)
    *(.literal._RNvNtNtCs*_18cranpose_app_shell11shell_frame12layout_phase20pending_repass_nodes* .text._RNvNtNtCs*_18cranpose_app_shell11shell_frame12layout_phase20pending_repass_nodes*)
    *(.literal._RNvNtNtCs*_20cranpose_ui_graphics6record11materialize17materialize_shape* .text._RNvNtNtCs*_20cranpose_ui_graphics6record11materialize17materialize_shape*)
    *(.literal._RNvNtNtCs*_22cranpose_render_common13scene_builder10dirty_walk14update_at_step* .text._RNvNtNtCs*_22cranpose_render_common13scene_builder10dirty_walk14update_at_step*)
    *(.literal._RNvNtNtCs*_22cranpose_render_common13scene_builder11inline_leaf12write_inline* .text._RNvNtNtCs*_22cranpose_render_common13scene_builder11inline_leaf12write_inline*)
    *(.literal._RNvNtNtCs*_22cranpose_render_common13scene_builder11inline_leaf13lowers_inline* .text._RNvNtNtCs*_22cranpose_render_common13scene_builder11inline_leaf13lowers_inline*)
    *(.literal._RNvNtNtCs*_22cranpose_render_common13scene_builder11inline_leaf19update_dirty_inline* .text._RNvNtNtCs*_22cranpose_render_common13scene_builder11inline_leaf19update_dirty_inline*)
    *(.literal._RNvNtNtCs*_22cranpose_render_common13scene_builder14draw_recording17append_draw_nodes* .text._RNvNtNtCs*_22cranpose_render_common13scene_builder14draw_recording17append_draw_nodes*)
    *(.literal._RNvNtNtCs*_22cranpose_render_pixels8pipeline10draw_child17render_draw_child* .text._RNvNtNtCs*_22cranpose_render_pixels8pipeline10draw_child17render_draw_child*)
    *(.literal._RNvX*Cs*_20cranpose_runtime_stdNt*12StdSchedulerNtNtCs*_13cranpose_core8platform16RuntimeScheduler14schedule_frame* .text._RNvX*Cs*_20cranpose_runtime_stdNt*12StdSchedulerNtNtCs*_13cranpose_core8platform16RuntimeScheduler14schedule_frame*)
    *(.literal._RNvX*Cs*_22cranpose_render_pixelsNt*14PixelsRendererNtCs*_22cranpose_render_common8Renderer25update_scene_from_applier* .text._RNvX*Cs*_22cranpose_render_pixelsNt*14PixelsRendererNtCs*_22cranpose_render_common8Renderer25update_scene_from_applier*)
    *(.literal._RNvX*NtCs*_11cranpose_ui12render_stateNt*15AppContextScopeNtNtNtCs*_4core3ops4drop4Drop4drop* .text._RNvX*NtCs*_11cranpose_ui12render_stateNt*15AppContextScopeNtNtNtCs*_4core3ops4drop4Drop4drop*)
    *(.literal._RNvX*NtCs*_11cranpose_ui18text_modifier_nodeNt*16TextModifierNodeNtNtCs*_19cranpose_foundation8modifier12ModifierNode14as_layout_node* .text._RNvX*NtCs*_11cranpose_ui18text_modifier_nodeNt*16TextModifierNodeNtNtCs*_19cranpose_foundation8modifier12ModifierNode14as_layout_node*)
    *(.literal._RNvX*NtCs*_13cranpose_core11snapshot_v2Nt*20CurrentSnapshotGuardNtNtNtCs*_4core3ops4drop4Drop4drop* .text._RNvX*NtCs*_13cranpose_core11snapshot_v2Nt*20CurrentSnapshotGuardNtNtNtCs*_4core3ops4drop4Drop4drop*)
    *(.literal._RNvX*NtCs*_13cranpose_core5stateINt*10TypedWritefENt*12PendingWrite5store* .text._RNvX*NtCs*_13cranpose_core5stateINt*10TypedWritefENt*12PendingWrite5store*)
    *(.literal._RNvX*NtCs*_13cranpose_core5stateINt*10TypedWritefENt*12PendingWrite7matches* .text._RNvX*NtCs*_13cranpose_core5stateINt*10TypedWritefENt*12PendingWrite7matches*)
    *(.literal._RNvX*NtCs*_13cranpose_core5stateINt*10TypedWritefENt*12PendingWrite7written* .text._RNvX*NtCs*_13cranpose_core5stateINt*10TypedWritefENt*12PendingWrite7written*)
    *(.literal._RNvX*NtCs*_13cranpose_core5stateINt*20SnapshotMutableStateINtNtCs*_4core6option6OptionNtNtCs*_11cranpose_ui12focus_within16FocusWithinChainEENt*11StateObject17observation_lease* .text._RNvX*NtCs*_13cranpose_core5stateINt*20SnapshotMutableStateINtNtCs*_4core6option6OptionNtNtCs*_11cranpose_ui12focus_within16FocusWithinChainEENt*11StateObject17observation_lease*)
    *(.literal._RNvX*NtCs*_13cranpose_core7runtimeNt*18StateTeardownScopeNtNtNtCs*_4core3ops4drop4Drop4drop* .text._RNvX*NtCs*_13cranpose_core7runtimeNt*18StateTeardownScopeNtNtNtCs*_4core3ops4drop4Drop4drop*)
    *(.literal._RNvX*NtCs*_18cranpose_animation9animationINt*24TransitionAnimationStatefENt*27InfiniteTransitionAnimation15has_subscribers* .text._RNvX*NtCs*_18cranpose_animation9animationINt*24TransitionAnimationStatefENt*27InfiniteTransitionAnimation15has_subscribers*)
    *(.literal._RNvX*NtCs*_4core3anyINtNtNtCs*_13cranpose_core7runtime11state_arena14TypedStateCellfENt*3Any7type_id* .text._RNvX*NtCs*_4core3anyINtNtNtCs*_13cranpose_core7runtime11state_arena14TypedStateCellfENt*3Any7type_id*)
    *(.literal._RNvX*NtCs*_4core3anyNtNtCs*_11cranpose_ui18text_modifier_node16TextModifierNodeNt*3Any7type_id* .text._RNvX*NtCs*_4core3anyNtNtCs*_11cranpose_ui18text_modifier_node16TextModifierNodeNt*3Any7type_id*)
    *(.literal._RNvX*NtCs*_4core3anyNtNtCs*_13cranpose_text11text_layout10TextLayoutNt*3Any7type_id* .text._RNvX*NtCs*_4core3anyNtNtCs*_13cranpose_text11text_layout10TextLayoutNt*3Any7type_id*)
    *(.literal._RNvX*NtCs*_4core3anyNtNtNtCs*_11cranpose_ui12render_state16draw_observation20DrawObservationScopeNt*3Any7type_id* .text._RNvX*NtCs*_4core3anyNtNtNtCs*_11cranpose_ui12render_state16draw_observation20DrawObservationScopeNt*3Any7type_id*)
    *(.literal._RNvX*NtCs*_4core3anyNtNtNtNtCs*_11cranpose_ui6layout8policies20empty_measure_policy18EmptyMeasurePolicyNt*3Any7type_id* .text._RNvX*NtCs*_4core3anyNtNtNtNtCs*_11cranpose_ui6layout8policies20empty_measure_policy18EmptyMeasurePolicyNt*3Any7type_id*)
    *(.literal._RNvX*NtCs*_4core3anyNtNtNtNtCs*_11cranpose_ui7widgets5nodes11layout_node10LayoutNodeNt*3Any7type_id* .text._RNvX*NtCs*_4core3anyNtNtNtNtCs*_11cranpose_ui7widgets5nodes11layout_node10LayoutNodeNt*3Any7type_id*)
    *(.literal._RNvX*NtNtCs*_13cranpose_core14memory_applier12applier_implNt*13MemoryApplierNtNt*7applier7Applier18begin_bubble_batch* .text._RNvX*NtNtCs*_13cranpose_core14memory_applier12applier_implNt*13MemoryApplierNtNt*7applier7Applier18begin_bubble_batch*)
    *(.literal._RNvX*NtNtNtCs*_4core4iter8adapters5chainINt*5ChainINtNt*3map3MapINtNt*7flatten7FlattenINtNt*6option8IntoIterRSNtNtCs*_13cranpose_core23snapshot_state_observer13ObservedStateEENCNvM**Nt*11ObservedIds4iter0EINt*7FlatMapI*RINtNtCs*_5alloc5boxed3BoxINtNtNtNtCs*_3std11collections4hash3map7HashMapNtNt*5state8ObjectIdINt*6OptionINtNt*2rc2RcDNtNt*3any3AnyEL_EEINtNt*4hash18BuildHasherDefaultNtNtNt*11collections9word_hash10WordHasherEEEEINtNt*6copied6CopiedINt*4Keys**EENC*s_0EENtNtNt*6traits8iterator8Iterator4next* .text._RNvX*NtNtNtCs*_4core4iter8adapters5chainINt*5ChainINtNt*3map3MapINtNt*7flatten7FlattenINtNt*6option8IntoIterRSNtNtCs*_13cranpose_core23snapshot_state_observer13ObservedStateEENCNvM**Nt*11ObservedIds4iter0EINt*7FlatMapI*RINtNtCs*_5alloc5boxed3BoxINtNtNtNtCs*_3std11collections4hash3map7HashMapNtNt*5state8ObjectIdINt*6OptionINtNt*2rc2RcDNtNt*3any3AnyEL_EEINtNt*4hash18BuildHasherDefaultNtNtNt*11collections9word_hash10WordHasherEEEEINtNt*6copied6CopiedINt*4Keys**EENC*s_0EENtNtNt*6traits8iterator8Iterator4next*)
    *(.literal._RNvX*NvM*NtCs*_13cranpose_core23snapshot_state_observerNt*26SnapshotStateObserverInner13observe_readsNt*22ActiveObservationGuardNtNtNtCs*_4core3ops4drop4Drop4drop* .text._RNvX*NvM*NtCs*_13cranpose_core23snapshot_state_observerNt*26SnapshotStateObserverInner13observe_readsNt*22ActiveObservationGuardNtNtNtCs*_4core3ops4drop4Drop4drop*)
    *(.literal._RNvX*NvNtNtCs*_22cranpose_render_pixels8pipeline10draw_child19push_draw_primitiveNt*12SceneEmitterNtNtCs*_22cranpose_render_common14primitive_emit17DrawPrimitiveSink10push_shape* .text._RNvX*NvNtNtCs*_22cranpose_render_pixels8pipeline10draw_child19push_draw_primitiveNt*12SceneEmitterNtNtCs*_22cranpose_render_common14primitive_emit17DrawPrimitiveSink10push_shape*)
    *(.literal._RNvYNCNvM*NtCs*_13cranpose_core12applier_hostINt*19ConcreteApplierHostNtNt*14memory_applier13MemoryApplierE5guard0INtNtNtCs*_4core3ops8function6FnOnceTQ*Nt*6NodeIdEE9call_once* .text._RNvYNCNvM*NtCs*_13cranpose_core12applier_hostINt*19ConcreteApplierHostNtNt*14memory_applier13MemoryApplierE5guard0INtNtNtCs*_4core3ops8function6FnOnceTQ*Nt*6NodeIdEE9call_once*)
  }
}
INSERT AFTER .iram0.text;

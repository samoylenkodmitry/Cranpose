/* Generated by scripts/esp32/hot_code.py from 5 profiles of apps/esp32-demo in QEMU's ESP32-S3, by cache misses.
 * 296 patterns, 125 KB, took 53% of the samples in Rust code.
 * See README.md beside this file. */
SECTIONS
{
  .iram0.cranpose :
  {
    . = ALIGN(4);
    *(.literal._RINvM*Cs*_22cranpose_render_pixelsNt*14PixelsRenderer20draw_picture_area_asNtNtCs*_22cranpose_render_common6rgb5658Rgb565BeE* .text._RINvM*Cs*_22cranpose_render_pixelsNt*14PixelsRenderer20draw_picture_area_asNtNtCs*_22cranpose_render_common6rgb5658Rgb565BeE*)
    *(.literal._RINvM*NtCs*_13cranpose_core23snapshot_state_observerNt*26SnapshotStateObserverInner16find_scope_entryNtNtNtCs*_11cranpose_ui12render_state16draw_observation20DrawObservationScopeE* .text._RINvM*NtCs*_13cranpose_core23snapshot_state_observerNt*26SnapshotStateObserverInner16find_scope_entryNtNtNtCs*_11cranpose_ui12render_state16draw_observation20DrawObservationScopeE*)
    *(.literal._RINvM*NtCs*_22cranpose_render_common15layer_recyclingNt*4Pool15recycle_keepingNCNCNv*15recycle_lowered00E* .text._RINvM*NtCs*_22cranpose_render_common15layer_recyclingNt*4Pool15recycle_keepingNCNCNv*15recycle_lowered00E*)
    *(.literal._RINvM*NtCs*_22cranpose_render_pixels12raster_sceneNt*11RasterScene9push_itemNt*8TextDrawE* .text._RINvM*NtCs*_22cranpose_render_pixels12raster_sceneNt*11RasterScene9push_itemNt*8TextDrawE*)
    *(.literal._RINvM*NtCs*_22cranpose_render_pixels12raster_sceneNt*11RasterScene9push_itemNt*9DrawShapeE* .text._RINvM*NtCs*_22cranpose_render_pixels12raster_sceneNt*11RasterScene9push_itemNt*9DrawShapeE*)
    *(.literal._RINvM*NtNtCs*_13cranpose_core11collections11bounded_lruINt*15BoundedLruCacheNtNtNtCs*_11cranpose_ui4text8text_key7TextKeyINtNt*9pass_aged4UsedINtCs*_8smallvec8SmallVecAINtNtCs*_5alloc2rc2RcNtNt*7measure18PreparedTextLayoutEj2_EEE4find*E* .text._RINvM*NtNtCs*_13cranpose_core11collections11bounded_lruINt*15BoundedLruCacheNtNtNtCs*_11cranpose_ui4text8text_key7TextKeyINtNt*9pass_aged4UsedINtCs*_8smallvec8SmallVecAINtNtCs*_5alloc2rc2RcNtNt*7measure18PreparedTextLayoutEj2_EEE4find*E*)
    *(.literal._RINvM*NtNtCs*_13cranpose_core11collections9pass_agedINt*13PassAgedCacheNtNtNtCs*_11cranpose_ui4text8text_key7TextKeyINtCs*_8smallvec8SmallVecAINtNtCs*_5alloc2rc2RcNtNt*7measure18PreparedTextLayoutEj2_EE7get_mut*E* .text._RINvM*NtNtCs*_13cranpose_core11collections9pass_agedINt*13PassAgedCacheNtNtNtCs*_11cranpose_ui4text8text_key7TextKeyINtCs*_8smallvec8SmallVecAINtNtCs*_5alloc2rc2RcNtNt*7measure18PreparedTextLayoutEj2_EE7get_mut*E*)
    *(.literal._RINvM*NtNtCs*_13cranpose_core7runtime11state_arenaNt*10StateArena9get_typedfE* .text._RINvM*NtNtCs*_13cranpose_core7runtime11state_arenaNt*10StateArena9get_typedfE*)
    *(.literal._RINvM*NtNtNtCs*_3std3sys12thread_local2osINt*7StorageNtNtCs*_11cranpose_ui12thread_state11ThreadCellsKj8_E14try_initializeNvNv*5CELLS27___rust_std_internal_init_fnE* .text._RINvM*NtNtNtCs*_3std3sys12thread_local2osINt*7StorageNtNtCs*_11cranpose_ui12thread_state11ThreadCellsKj8_E14try_initializeNvNv*5CELLS27___rust_std_internal_init_fnE*)
    *(.literal._RINvNtCs*_12futures_task5waker12drop_arc_rawNtNtCs*_13cranpose_core7runtime16RuntimeTaskWakerE* .text._RINvNtCs*_12futures_task5waker12drop_arc_rawNtNtCs*_13cranpose_core7runtime16RuntimeTaskWakerE*)
    *(.literal._RINvNtCs*_12futures_task5waker12wake_arc_rawNtNtCs*_13cranpose_core7runtime16RuntimeTaskWakerE* .text._RINvNtCs*_12futures_task5waker12wake_arc_rawNtNtCs*_13cranpose_core7runtime16RuntimeTaskWakerE*)
    *(.literal._RINvNtCs*_12futures_task5waker13clone_arc_rawNtNtCs*_13cranpose_core7runtime16RuntimeTaskWakerE* .text._RINvNtCs*_12futures_task5waker13clone_arc_rawNtNtCs*_13cranpose_core7runtime16RuntimeTaskWakerE*)
    *(.literal._RINvNtCs*_18cranpose_app_shell7surface22route_batch_by_surfaceNtCs*_22cranpose_render_pixels14PixelsRendererINtNtNtNtCs*_4core4iter8adapters6copied6CopiedINtNtNt*5slice4iter4IterNtCs*_13cranpose_core6NodeIdEEE* .text._RINvNtCs*_18cranpose_app_shell7surface22route_batch_by_surfaceNtCs*_22cranpose_render_pixels14PixelsRendererINtNtNtNtCs*_4core4iter8adapters6copied6CopiedINtNtNt*5slice4iter4IterNtCs*_13cranpose_core6NodeIdEEE*)
    *(.literal._RINvNtCs*_22cranpose_render_common11text_canvas21draw_mask_glyph_solidNtNt*6rgb5658Rgb565BeNt*9OverBlendE* .text._RINvNtCs*_22cranpose_render_common11text_canvas21draw_mask_glyph_solidNtNt*6rgb5658Rgb565BeNt*9OverBlendE*)
    *(.literal._RINvNtCs*_4core3any9type_nameINtNtCs*_13cranpose_core9callbacks16ParamReturnStateTNtNtCs*_11cranpose_ui19selection_container18SelectionRegistrarINtNtCs*_5alloc2rc2RcNtNtCs*_13cranpose_text16annotated_string15AnnotatedStringEINtNt*4sync3ArcNtNt*5style9TextStyleENtNt*14layout_options17TextLayoutOptionsENtNt*8modifier8ModifierEE* .text._RINvNtCs*_4core3any9type_nameINtNtCs*_13cranpose_core9callbacks16ParamReturnStateTNtNtCs*_11cranpose_ui19selection_container18SelectionRegistrarINtNtCs*_5alloc2rc2RcNtNtCs*_13cranpose_text16annotated_string15AnnotatedStringEINtNt*4sync3ArcNtNt*5style9TextStyleENtNt*14layout_options17TextLayoutOptionsENtNt*8modifier8ModifierEE*)
    *(.literal._RINvNtCs*_4core3ptr9drop_glueINtCs*_8smallvec8SmallVecAINtNtCs*_5alloc2rc2RcDNtNtCs*_19cranpose_foundation8modifier18AnyModifierElementEL_Ej4_EE* .text._RINvNtCs*_4core3ptr9drop_glueINtCs*_8smallvec8SmallVecAINtNtCs*_5alloc2rc2RcDNtNtCs*_19cranpose_foundation8modifier18AnyModifierElementEL_Ej4_EE*)
    *(.literal._RINvNtCs*_4core3ptr9drop_glueINtCs*_8smallvec8SmallVecAINtNtCs*_5alloc5boxed3BoxDNtNtCs*_13cranpose_core5state11RecordValueEL_Ej2_EE* .text._RINvNtCs*_4core3ptr9drop_glueINtCs*_8smallvec8SmallVecAINtNtCs*_5alloc5boxed3BoxDNtNtCs*_13cranpose_core5state11RecordValueEL_Ej2_EE*)
    *(.literal._RINvNtCs*_4core3ptr9drop_glueINtNt*6option6OptionINtNtCs*_5alloc5boxed3BoxNtNtCs*_22cranpose_render_pixels12raster_scene8HitLayerEEE* .text._RINvNtCs*_4core3ptr9drop_glueINtNt*6option6OptionINtNtCs*_5alloc5boxed3BoxNtNtCs*_22cranpose_render_pixels12raster_scene8HitLayerEEE*)
    *(.literal._RINvNtCs*_4core3ptr9drop_glueINtNt*6option6OptionINtNtCs*_5alloc5boxed3BoxNtNtCs*_22cranpose_render_pixels7rewrite7RewriteEEE* .text._RINvNtCs*_4core3ptr9drop_glueINtNt*6option6OptionINtNtCs*_5alloc5boxed3BoxNtNtCs*_22cranpose_render_pixels7rewrite7RewriteEEE*)
    *(.literal._RINvNtCs*_4core3ptr9drop_glueINtNt*6result6ResultRINtNtCs*_5alloc2rc2RcDNtNtCs*_18cranpose_ui_layout4core13MeasurePolicyEL_ET**EEE* .text._RINvNtCs*_4core3ptr9drop_glueINtNt*6result6ResultRINtNtCs*_5alloc2rc2RcDNtNtCs*_18cranpose_ui_layout4core13MeasurePolicyEL_ET**EEE*)
    *(.literal._RINvNtCs*_4core3ptr9drop_glueINtNtCs*_18cranpose_animation9animation24TransitionAnimationStatefEE* .text._RINvNtCs*_4core3ptr9drop_glueINtNtCs*_18cranpose_animation9animation24TransitionAnimationStatefEE*)
    *(.literal._RINvNtCs*_4core3ptr9drop_glueINtNtCs*_19cranpose_foundation8modifier20TypedModifierElementNtNtCs*_11cranpose_ui18text_modifier_node19TextModifierElementEE* .text._RINvNtCs*_4core3ptr9drop_glueINtNtCs*_19cranpose_foundation8modifier20TypedModifierElementNtNtCs*_11cranpose_ui18text_modifier_node19TextModifierElementEE*)
    *(.literal._RINvNtCs*_4core3ptr9drop_glueINtNtCs*_5alloc3vec3VecINtNtCs*_13cranpose_text16annotated_string10RangeStyleNtNt*5style9SpanStyleEEE* .text._RINvNtCs*_4core3ptr9drop_glueINtNtCs*_5alloc3vec3VecINtNtCs*_13cranpose_text16annotated_string10RangeStyleNtNt*5style9SpanStyleEEE*)
    *(.literal._RINvNtCs*_4core3ptr9drop_glueINtNtCs*_5alloc5boxed3BoxNtNtCs*_22cranpose_render_common5graph17TextPrimitiveNodeEE* .text._RINvNtCs*_4core3ptr9drop_glueINtNtCs*_5alloc5boxed3BoxNtNtCs*_22cranpose_render_common5graph17TextPrimitiveNodeEE*)
    *(.literal._RINvNtCs*_4core3ptr9drop_glueINtNtNtCs*_13cranpose_core7runtime11state_arena14TypedStateCellfEE* .text._RINvNtCs*_4core3ptr9drop_glueINtNtNtCs*_13cranpose_core7runtime11state_arena14TypedStateCellfEE*)
    *(.literal._RINvNtCs*_4core3ptr9drop_glueINtNtNtCs*_5alloc3vec9into_iter8IntoIterNtNtNtCs*_13cranpose_core11snapshot_v27mutable14ApplyOperationEE* .text._RINvNtCs*_4core3ptr9drop_glueINtNtNtCs*_5alloc3vec9into_iter8IntoIterNtNtNtCs*_13cranpose_core11snapshot_v27mutable14ApplyOperationEE*)
    *(.literal._RINvNtCs*_4core3ptr9drop_glueINtNtNtNtCs*_3std11collections4hash3map7HashMapNtNtCs*_13cranpose_core5state8ObjectIdTINtNtCs*_5alloc2rc2RcDNt*11StateObjectEL_ENtNt*15snapshot_id_set10SnapshotIdEINtNt*4hash18BuildHasherDefaultNtNtNt*11collections9word_hash10WordHasherEEE* .text._RINvNtCs*_4core3ptr9drop_glueINtNtNtNtCs*_3std11collections4hash3map7HashMapNtNtCs*_13cranpose_core5state8ObjectIdTINtNtCs*_5alloc2rc2RcDNt*11StateObjectEL_ENtNt*15snapshot_id_set10SnapshotIdEINtNt*4hash18BuildHasherDefaultNtNtNt*11collections9word_hash10WordHasherEEE*)
    *(.literal._RINvNtCs*_4core3ptr9drop_glueNCNvM*NtCs*_13cranpose_core23snapshot_state_observerNt*26SnapshotStateObserverInner12handle_apply0E* .text._RINvNtCs*_4core3ptr9drop_glueNCNvM*NtCs*_13cranpose_core23snapshot_state_observerNt*26SnapshotStateObserverInner12handle_apply0E*)
    *(.literal._RINvNtCs*_4core3ptr9drop_glueNtCs*_20cranpose_runtime_std12StdSchedulerE* .text._RINvNtCs*_4core3ptr9drop_glueNtCs*_20cranpose_runtime_std12StdSchedulerE*)
    *(.literal._RINvNtCs*_4core3ptr9drop_glueNtNtCs*_11cranpose_ui18text_modifier_node16TextModifierNodeE* .text._RINvNtCs*_4core3ptr9drop_glueNtNtCs*_11cranpose_ui18text_modifier_node16TextModifierNodeE*)
    *(.literal._RINvNtCs*_4core3ptr9drop_glueNtNtCs*_11cranpose_ui6layout13LayoutBuilderE* .text._RINvNtCs*_4core3ptr9drop_glueNtNtCs*_11cranpose_ui6layout13LayoutBuilderE*)
    *(.literal._RINvNtCs*_4core3ptr9drop_glueNtNtCs*_13cranpose_core11frame_clock9NextFrameE* .text._RINvNtCs*_4core3ptr9drop_glueNtNtCs*_13cranpose_core11frame_clock9NextFrameE*)
    *(.literal._RINvNtCs*_4core3ptr9drop_glueNtNtCs*_13cranpose_core11snapshot_v211AnySnapshotE* .text._RINvNtCs*_4core3ptr9drop_glueNtNtCs*_13cranpose_core11snapshot_v211AnySnapshotE*)
    *(.literal._RINvNtCs*_4core3ptr9drop_glueNtNtCs*_13cranpose_text11text_layout10TextLayoutE* .text._RINvNtCs*_4core3ptr9drop_glueNtNtCs*_13cranpose_text11text_layout10TextLayoutE*)
    *(.literal._RINvNtCs*_4core3ptr9drop_glueNtNtNtCs*_11cranpose_ui4text7measure18PreparedTextLayoutE* .text._RINvNtCs*_4core3ptr9drop_glueNtNtNtCs*_11cranpose_ui4text7measure18PreparedTextLayoutE*)
    *(.literal._RINvNtCs*_4core3ptr9drop_glueNtNtNtCs*_13cranpose_core11snapshot_v214snapshot_state13SnapshotStateE* .text._RINvNtCs*_4core3ptr9drop_glueNtNtNtCs*_13cranpose_core11snapshot_v214snapshot_state13SnapshotStateE*)
    *(.literal._RINvNtNtNtCs*_3std3sys12thread_local2os13destroy_valueNtNtCs*_22cranpose_render_common12thread_state17RenderThreadStateKj8_E* .text._RINvNtNtNtCs*_3std3sys12thread_local2os13destroy_valueNtNtCs*_22cranpose_render_common12thread_state17RenderThreadStateKj8_E*)
    *(.literal._RINvX*Cs*_8smallvecINt*8SmallVecAINtNtCs*_5alloc5boxed3BoxDNtNtCs*_13cranpose_core5state11RecordValueEL_Ej2_EINtNtNtNtCs*_4core4iter6traits7collect6Extend*E6extendINtNt*6option6Option*EE* .text._RINvX*Cs*_8smallvecINt*8SmallVecAINtNtCs*_5alloc5boxed3BoxDNtNtCs*_13cranpose_core5state11RecordValueEL_Ej2_EINtNtNtNtCs*_4core4iter6traits7collect6Extend*E6extendINtNt*6option6Option*EE*)
    *(.literal._RNCINvM*NtCs*_13cranpose_core15launched_effectNt*24LaunchedEffectAsyncState6launchNCINvNt*11concurrency13CollectEventsNtNtCs*_17cranpose_services10navigation12BackDeliverybNCINv*21PredictiveBackHandlerNCINv*11BackHandlerNCNvNtCs*_8cranpose12platform_env31___cranpose_body_RootBackHandler0E0*Es_0E0E0* .text._RNCINvM*NtCs*_13cranpose_core15launched_effectNt*24LaunchedEffectAsyncState6launchNCINvNt*11concurrency13CollectEventsNtNtCs*_17cranpose_services10navigation12BackDeliverybNCINv*21PredictiveBackHandlerNCINv*11BackHandlerNCNvNtCs*_8cranpose12platform_env31___cranpose_body_RootBackHandler0E0*Es_0E0E0*)
    *(.literal._RNCINvNtCs*_13cranpose_core18composition_locals18compositionLocalOfINtNtCs*_4core6option6OptionNtNtCs*_11cranpose_ui19selection_container18SelectionRegistrarENCNCNvNtNt*7widgets19selection_container25local_selection_registrars_00E0* .text._RNCINvNtCs*_13cranpose_core18composition_locals18compositionLocalOfINtNtCs*_4core6option6OptionNtNtCs*_11cranpose_ui19selection_container18SelectionRegistrarENCNCNvNtNt*7widgets19selection_container25local_selection_registrars_00E0*)
    *(.literal._RNCINvNtCs*_13cranpose_core18composition_locals24staticCompositionLocalOfNtNtNtCs*_11cranpose_ui7widgets5popup13PopupRegistryNvM***8detachedE0* .text._RNCINvNtCs*_13cranpose_core18composition_locals24staticCompositionLocalOfNtNtNtCs*_11cranpose_ui7widgets5popup13PopupRegistryNvM***8detachedE0*)
    *(.literal._RNCINvNtNtCs*_22cranpose_render_common13scene_builder10node_layer21read_placed_node_databNCINvNt*12lowered_node16lower_node_alonebNCNvM*NtCs*_22cranpose_render_pixels11layout_walkNt*10LayoutWalk5lower0E0E0* .text._RNCINvNtNtCs*_22cranpose_render_common13scene_builder10node_layer21read_placed_node_databNCINvNt*12lowered_node16lower_node_alonebNCNvM*NtCs*_22cranpose_render_pixels11layout_walkNt*10LayoutWalk5lower0E0E0*)
    *(.literal._RNCINvNtNtCs*_22cranpose_render_common13scene_builder12lowered_node15visit_kept_nodeINtNtCs*_4core6result6ResultuNtNtNtCs*_22cranpose_render_pixels8pipeline8in_place4StopENCNvM**Nt*6Repush10visit_node0E0* .text._RNCINvNtNtCs*_22cranpose_render_common13scene_builder12lowered_node15visit_kept_nodeINtNtCs*_4core6result6ResultuNtNtNtCs*_22cranpose_render_pixels8pipeline8in_place4StopENCNvM**Nt*6Repush10visit_node0E0*)
    *(.literal._RNCNCINvM*NtCs*_13cranpose_core23snapshot_state_observerNt*26SnapshotStateObserverInner13observe_readsNtNtNtCs*_11cranpose_ui12render_state16draw_observation20DrawObservationScopeNtNtCs*_20cranpose_ui_graphics8geometry13GraphicsLayerNCINv*18observe_draw_reads*NCNCNCNvM*Nt*14modifier_nodesNt*17GraphicsLayerNode14layer_resolver000Es_0*E00* .text._RNCNCINvM*NtCs*_13cranpose_core23snapshot_state_observerNt*26SnapshotStateObserverInner13observe_readsNtNtNtCs*_11cranpose_ui12render_state16draw_observation20DrawObservationScopeNtNtCs*_20cranpose_ui_graphics8geometry13GraphicsLayerNCINv*18observe_draw_reads*NCNCNCNvM*Nt*14modifier_nodesNt*17GraphicsLayerNode14layer_resolver000Es_0*E00*)
    *(.literal._RNCNCNCNvNtNtCs*_11cranpose_ui7widgets17shared_transition14local_registry000* .text._RNCNCNCNvNtNtCs*_11cranpose_ui7widgets17shared_transition14local_registry000*)
    *(.literal._RNCNCNvM*NtCs*_18cranpose_animation9animationNt*18InfiniteTransition3run00* .text._RNCNCNvM*NtCs*_18cranpose_animation9animationNt*18InfiniteTransition3run00*)
    *(.literal._RNCNvM*NtCs*_13cranpose_core23snapshot_state_observerNt*26SnapshotStateObserverInner5start0* .text._RNCNvM*NtCs*_13cranpose_core23snapshot_state_observerNt*26SnapshotStateObserverInner5start0*)
    *(.literal._RNCNvM*NtNtCs*_11cranpose_ui8modifier10focus_ringNt*8Modifier9focusable0* .text._RNCNvM*NtNtCs*_11cranpose_ui8modifier10focus_ringNt*8Modifier9focusable0*)
    *(.literal._RNCNvM*NtNtCs*_22cranpose_render_pixels4draw5reachNtNt*12raster_scene11RasterScene13covers_window0* .text._RNCNvM*NtNtCs*_22cranpose_render_pixels4draw5reachNtNt*12raster_scene11RasterScene13covers_window0*)
    *(.literal._RNCNvM*NtNtNtCs*_11cranpose_ui8modifier6slices8snapshotNt*11Backgrounds11insert_into0* .text._RNCNvM*NtNtNtCs*_11cranpose_ui8modifier6slices8snapshotNt*11Backgrounds11insert_into0*)
    *(.literal._RNCNvNtCs*_11cranpose_ui14modifier_nodes20observe_draw_command0* .text._RNCNvNtCs*_11cranpose_ui14modifier_nodes20observe_draw_command0*)
    *(.literal._RNCNvNtCs*_11cranpose_ui18text_modifier_node17shared_text_style0* .text._RNCNvNtCs*_11cranpose_ui18text_modifier_node17shared_text_style0*)
    *(.literal._RNCNvNtCs*_22cranpose_render_common15layer_recycling18keep_for_next_walk0* .text._RNCNvNtCs*_22cranpose_render_common15layer_recycling18keep_for_next_walk0*)
    *(.literal._RNSNvYNCINvM*NtCs*_13cranpose_core23snapshot_state_observerNt*26SnapshotStateObserverInner3newNCNvNtNtCs*_11cranpose_ui12render_state16draw_observation17new_draw_observer0E0INtNtNtCs*_4core3ops8function6FnOnceTRDNtNt*5state11StateObjectEL_EE9call_once6vtable* .text._RNSNvYNCINvM*NtCs*_13cranpose_core23snapshot_state_observerNt*26SnapshotStateObserverInner3newNCNvNtNtCs*_11cranpose_ui12render_state16draw_observation17new_draw_observer0E0INtNtNtCs*_4core3ops8function6FnOnceTRDNtNt*5state11StateObjectEL_EE9call_once6vtable*)
    *(.literal._RNSNvYNCNCINvM*NtCs*_13cranpose_core23snapshot_state_observerNt*26SnapshotStateObserverInner13observe_readsNtNtNtCs*_11cranpose_ui12render_state16draw_observation20DrawObservationScopeNtNtCs*_20cranpose_ui_graphics8geometry13GraphicsLayerNCINv*18observe_draw_reads*NCNCNCNvM*Nt*14modifier_nodesNt*17GraphicsLayerNode14layer_resolver000Es_0*E00INtNtNtCs*_4core3ops8function6FnOnceTRDNtNt*3any3AnyEL_EE9call_once6vtable* .text._RNSNvYNCNCINvM*NtCs*_13cranpose_core23snapshot_state_observerNt*26SnapshotStateObserverInner13observe_readsNtNtNtCs*_11cranpose_ui12render_state16draw_observation20DrawObservationScopeNtNtCs*_20cranpose_ui_graphics8geometry13GraphicsLayerNCINv*18observe_draw_reads*NCNCNCNvM*Nt*14modifier_nodesNt*17GraphicsLayerNode14layer_resolver000Es_0*E00INtNtNtCs*_4core3ops8function6FnOnceTRDNtNt*3any3AnyEL_EE9call_once6vtable*)
    *(.literal._RNSNvYNCNCINvNtCs*_13cranpose_core11concurrency19rememberEventStreamNtNtCs*_17cranpose_services10navigation12BackDeliverybINtNtCs*_4core6option6OptionNt*16BackInterceptionENCINv*21PredictiveBackHandlerNCINv*11BackHandlerNCNvNtCs*_8cranpose12platform_env31___cranpose_body_RootBackHandler0E0*E0Es0_00INtNtNt*3ops8function6FnOnceuE9call_once6vtable* .text._RNSNvYNCNCINvNtCs*_13cranpose_core11concurrency19rememberEventStreamNtNtCs*_17cranpose_services10navigation12BackDeliverybINtNtCs*_4core6option6OptionNt*16BackInterceptionENCINv*21PredictiveBackHandlerNCINv*11BackHandlerNCNvNtCs*_8cranpose12platform_env31___cranpose_body_RootBackHandler0E0*E0Es0_00INtNtNt*3ops8function6FnOnceuE9call_once6vtable*)
    *(.literal._RNSNvYNCNCNvNtNtNtCs*_11cranpose_ui8modifier6slices8snapshot19placed_draw_command00INtNtNtCs*_4core3ops8function6FnOnceTQNtNtCs*_20cranpose_ui_graphics8geometry16DrawScopeDefaultEE9call_once6vtable* .text._RNSNvYNCNCNvNtNtNtCs*_11cranpose_ui8modifier6slices8snapshot19placed_draw_command00INtNtNtCs*_4core3ops8function6FnOnceTQNtNtCs*_20cranpose_ui_graphics8geometry16DrawScopeDefaultEE9call_once6vtable*)
    *(.literal._RNSNvYNCNvM*NtCs*_13cranpose_core23snapshot_state_observerNt*26SnapshotStateObserverInner12handle_apply0INtNtNtCs*_4core3ops8function6FnOnceuE9call_once6vtable* .text._RNSNvYNCNvM*NtCs*_13cranpose_core23snapshot_state_observerNt*26SnapshotStateObserverInner12handle_apply0INtNtNtCs*_4core3ops8function6FnOnceuE9call_once6vtable*)
    *(.literal._RNSNvYNCNvM*NtCs*_13cranpose_core23snapshot_state_observerNt*26SnapshotStateObserverInner5start0INtNtNtCs*_4core3ops8function6FnOnceTRSINtNtCs*_5alloc2rc2RcDNtNt*5state11StateObjectEL_ENtNt*15snapshot_id_set10SnapshotIdEE9call_once6vtable* .text._RNSNvYNCNvM*NtCs*_13cranpose_core23snapshot_state_observerNt*26SnapshotStateObserverInner5start0INtNtNtCs*_4core3ops8function6FnOnceTRSINtNtCs*_5alloc2rc2RcDNtNt*5state11StateObjectEL_ENtNt*15snapshot_id_set10SnapshotIdEE9call_once6vtable*)
    *(.literal._RNSNvYNCNvNtCs*_11cranpose_ui14modifier_nodes20observe_draw_command0INtNtNtCs*_4core3ops8function6FnOnceTQNtNtCs*_20cranpose_ui_graphics8geometry16DrawScopeDefaultEE9call_once6vtable* .text._RNSNvYNCNvNtCs*_11cranpose_ui14modifier_nodes20observe_draw_command0INtNtNtCs*_4core3ops8function6FnOnceTQNtNtCs*_20cranpose_ui_graphics8geometry16DrawScopeDefaultEE9call_once6vtable*)
    *(.literal._RNSNvYNCNvNtNtCs*_11cranpose_ui12render_state16draw_observation17new_draw_observer0INtNtNtCs*_4core3ops8function6FnOnceTINtNtCs*_5alloc5boxed3BoxDI*uEp6OutputuEL_EEE9call_once6vtable* .text._RNSNvYNCNvNtNtCs*_11cranpose_ui12render_state16draw_observation17new_draw_observer0INtNtNtCs*_4core3ops8function6FnOnceTINtNtCs*_5alloc5boxed3BoxDI*uEp6OutputuEL_EEE9call_once6vtable*)
    *(.literal._RNSNvYNvYNtNtCs*_11cranpose_ui16layout_direction15LayoutDirectionNtNtCs*_4core7default7Default7defaultINtNtNt*3ops8function6FnOnceuE9call_once6vtable* .text._RNSNvYNvYNtNtCs*_11cranpose_ui16layout_direction15LayoutDirectionNtNtCs*_4core7default7Default7defaultINtNtNt*3ops8function6FnOnceuE9call_once6vtable*)
    *(.literal._RNvCs*_25cranpose_platform_esp_idf5drive* .text._RNvCs*_25cranpose_platform_esp_idf5drive*)
    *(.literal._RNvM*Cs*_18cranpose_app_shellINt*8AppShellNtCs*_22cranpose_render_pixels14PixelsRendererE22update_with_frame_time* .text._RNvM*Cs*_18cranpose_app_shellINt*8AppShellNtCs*_22cranpose_render_pixels14PixelsRendererE22update_with_frame_time*)
    *(.literal._RNvM*NtCs*_11cranpose_ui12render_stateNt*10AppContext11enter_scope* .text._RNvM*NtCs*_11cranpose_ui12render_stateNt*10AppContext11enter_scope*)
    *(.literal._RNvM*NtCs*_11cranpose_ui12render_stateNt*10AppContext17has_focused_field* .text._RNvM*NtCs*_11cranpose_ui12render_stateNt*10AppContext17has_focused_field*)
    *(.literal._RNvM*NtCs*_11cranpose_ui6layoutNt*18LayoutBuilderState12measure_node* .text._RNvM*NtCs*_11cranpose_ui6layoutNt*18LayoutBuilderState12measure_node*)
    *(.literal._RNvM*NtCs*_11cranpose_ui8modifierNt*8Modifier11eq_internal* .text._RNvM*NtCs*_11cranpose_ui8modifierNt*8Modifier11eq_internal*)
    *(.literal._RNvM*NtCs*_13cranpose_core11snapshot_v2Nt*11AnySnapshot7invalid* .text._RNvM*NtCs*_13cranpose_core11snapshot_v2Nt*11AnySnapshot7invalid*)
    *(.literal._RNvM*NtCs*_13cranpose_core11snapshot_v2Nt*20CurrentSnapshotGuard5enter* .text._RNvM*NtCs*_13cranpose_core11snapshot_v2Nt*20CurrentSnapshotGuard5enter*)
    *(.literal._RNvM*NtCs*_13cranpose_core13bubble_passesNt*12BubblePasses4note* .text._RNvM*NtCs*_13cranpose_core13bubble_passesNt*12BubblePasses4note*)
    *(.literal._RNvM*NtCs*_13cranpose_core15recompose_scopeNt*14RecomposeScope13run_recompose* .text._RNvM*NtCs*_13cranpose_core15recompose_scopeNt*14RecomposeScope13run_recompose*)
    *(.literal._RNvM*NtCs*_13cranpose_core15recompose_scopeNt*14RecomposeScope15mark_recomposed* .text._RNvM*NtCs*_13cranpose_core15recompose_scopeNt*14RecomposeScope15mark_recomposed*)
    *(.literal._RNvM*NtCs*_13cranpose_core15recompose_scopeNt*14RecomposeScope20enqueue_invalidation* .text._RNvM*NtCs*_13cranpose_core15recompose_scopeNt*14RecomposeScope20enqueue_invalidation*)
    *(.literal._RNvM*NtCs*_13cranpose_core15recompose_scopeNt*19RecomposeScopeInner21is_effectively_active* .text._RNvM*NtCs*_13cranpose_core15recompose_scopeNt*19RecomposeScopeInner21is_effectively_active*)
    *(.literal._RNvM*NtCs*_13cranpose_core23snapshot_state_observerNt*20ReadObservationStack4push* .text._RNvM*NtCs*_13cranpose_core23snapshot_state_observerNt*20ReadObservationStack4push*)
    *(.literal._RNvM*NtCs*_13cranpose_core5stateINt*12MutableStatefE7replace* .text._RNvM*NtCs*_13cranpose_core5stateINt*12MutableStatefE7replace*)
    *(.literal._RNvM*NtCs*_13cranpose_core5stateNt*11WriteTarget19finish_global_write* .text._RNvM*NtCs*_13cranpose_core5stateNt*11WriteTarget19finish_global_write*)
    *(.literal._RNvM*NtCs*_13cranpose_core5stateNt*13StateWatchers10invalidate* .text._RNvM*NtCs*_13cranpose_core5stateNt*13StateWatchers10invalidate*)
    *(.literal._RNvM*NtCs*_13cranpose_core7commandNt*11DirtyBubble4walk* .text._RNvM*NtCs*_13cranpose_core7commandNt*11DirtyBubble4walk*)
    *(.literal._RNvM*NtCs*_13cranpose_core7runtimeNt*12RuntimeInner14recycle_scopes* .text._RNvM*NtCs*_13cranpose_core7runtimeNt*12RuntimeInner14recycle_scopes*)
    *(.literal._RNvM*NtCs*_13cranpose_core7runtimeNt*12RuntimeInner15run_local_tasks* .text._RNvM*NtCs*_13cranpose_core7runtimeNt*12RuntimeInner15run_local_tasks*)
    *(.literal._RNvM*NtCs*_13cranpose_core7runtimeNt*12RuntimeInner16poll_async_tasks* .text._RNvM*NtCs*_13cranpose_core7runtimeNt*12RuntimeInner16poll_async_tasks*)
    *(.literal._RNvM*NtCs*_13cranpose_core7runtimeNt*12RuntimeInner23register_frame_callback* .text._RNvM*NtCs*_13cranpose_core7runtimeNt*12RuntimeInner23register_frame_callback*)
    *(.literal._RNvM*NtCs*_13cranpose_core7runtimeNt*12RuntimeInner25clear_needs_frame_if_idle* .text._RNvM*NtCs*_13cranpose_core7runtimeNt*12RuntimeInner25clear_needs_frame_if_idle*)
    *(.literal._RNvM*NtCs*_13cranpose_core7runtimeNt*13RuntimeHandle15enqueue_ui_task* .text._RNvM*NtCs*_13cranpose_core7runtimeNt*13RuntimeHandle15enqueue_ui_task*)
    *(.literal._RNvM*NtCs*_13cranpose_core7runtimeNt*7Runtime14has_pending_ui* .text._RNvM*NtCs*_13cranpose_core7runtimeNt*7Runtime14has_pending_ui*)
    *(.literal._RNvM*NtCs*_13cranpose_text12plain_glyphsNt*11PlainGlyphs6append* .text._RNvM*NtCs*_13cranpose_text12plain_glyphsNt*11PlainGlyphs6append*)
    *(.literal._RNvM*NtCs*_13cranpose_text13text_layouterNt*12TextLayouter12finish_lines* .text._RNvM*NtCs*_13cranpose_text13text_layouterNt*12TextLayouter12finish_lines*)
    *(.literal._RNvM*NtCs*_13cranpose_text13text_layouterNt*12TextLayouter15paragraph_level* .text._RNvM*NtCs*_13cranpose_text13text_layouterNt*12TextLayouter15paragraph_level*)
    *(.literal._RNvM*NtCs*_13cranpose_text13text_layouterNt*12TextLayouter4fill* .text._RNvM*NtCs*_13cranpose_text13text_layouterNt*12TextLayouter4fill*)
    *(.literal._RNvM*NtCs*_13cranpose_text13text_layouterNt*12TextLayouter5place* .text._RNvM*NtCs*_13cranpose_text13text_layouterNt*12TextLayouter5place*)
    *(.literal._RNvM*NtCs*_13cranpose_text13text_layouterNt*12TextLayouter5shape* .text._RNvM*NtCs*_13cranpose_text13text_layouterNt*12TextLayouter5shape*)
    *(.literal._RNvM*NtCs*_13cranpose_text13text_layouterNt*12TextLayouter9push_line* .text._RNvM*NtCs*_13cranpose_text13text_layouterNt*12TextLayouter9push_line*)
    *(.literal._RNvM*NtCs*_13cranpose_text6shaperNt*6Shaper5shape* .text._RNvM*NtCs*_13cranpose_text6shaperNt*6Shaper5shape*)
    *(.literal._RNvM*NtCs*_13cranpose_text8typefaceNt*8Typeface12line_metrics* .text._RNvM*NtCs*_13cranpose_text8typefaceNt*8Typeface12line_metrics*)
    *(.literal._RNvM*NtCs*_18cranpose_app_shell11shell_frameNt*11SurfaceDirt8classify* .text._RNvM*NtCs*_18cranpose_app_shell11shell_frameNt*11SurfaceDirt8classify*)
    *(.literal._RNvM*NtCs*_20cranpose_ui_graphics13shape_recordsNt*12ShapeRecords4push* .text._RNvM*NtCs*_20cranpose_ui_graphics13shape_recordsNt*12ShapeRecords4push*)
    *(.literal._RNvM*NtCs*_20cranpose_ui_graphics6recordNt*13ShapeRecorder11push_shaded* .text._RNvM*NtCs*_20cranpose_ui_graphics6recordNt*13ShapeRecorder11push_shaded*)
    *(.literal._RNvM*NtCs*_20cranpose_ui_graphics6recordNt*16CommandRecording10summary_in* .text._RNvM*NtCs*_20cranpose_ui_graphics6recordNt*16CommandRecording10summary_in*)
    *(.literal._RNvM*NtCs*_20cranpose_ui_graphics9transformNt*19ProjectiveTransform15bounds_for_rect* .text._RNvM*NtCs*_20cranpose_ui_graphics9transformNt*19ProjectiveTransform15bounds_for_rect*)
    *(.literal._RNvM*NtCs*_22cranpose_render_common14primitive_emitNt*14ShapePlacement4fill* .text._RNvM*NtCs*_22cranpose_render_common14primitive_emitNt*14ShapePlacement4fill*)
    *(.literal._RNvM*NtCs*_22cranpose_render_common15text_mask_gammaNt*13TextLuminance8of_color* .text._RNvM*NtCs*_22cranpose_render_common15text_mask_gammaNt*13TextLuminance8of_color*)
    *(.literal._RNvM*NtCs*_22cranpose_render_pixels11layout_walkNt*10LayoutWalk7release* .text._RNvM*NtCs*_22cranpose_render_pixels11layout_walkNt*10LayoutWalk7release*)
    *(.literal._RNvM*NtCs*_22cranpose_render_pixels11layout_walkNt*10LayoutWalk8is_clean* .text._RNvM*NtCs*_22cranpose_render_pixels11layout_walkNt*10LayoutWalk8is_clean*)
    *(.literal._RNvM*NtCs*_22cranpose_render_pixels11layout_walkNt*11OldChildren2of* .text._RNvM*NtCs*_22cranpose_render_pixels11layout_walkNt*11OldChildren2of*)
    *(.literal._RNvM*NtCs*_22cranpose_render_pixels12raster_sceneNt*11RasterScene12open_subtree* .text._RNvM*NtCs*_22cranpose_render_pixels12raster_sceneNt*11RasterScene12open_subtree*)
    *(.literal._RNvM*NtCs*_22cranpose_render_pixels12raster_sceneNt*11RasterScene12subtree_span* .text._RNvM*NtCs*_22cranpose_render_pixels12raster_sceneNt*11RasterScene12subtree_span*)
    *(.literal._RNvM*NtCs*_22cranpose_render_pixels12raster_sceneNt*11RasterScene13close_subtree* .text._RNvM*NtCs*_22cranpose_render_pixels12raster_sceneNt*11RasterScene13close_subtree*)
    *(.literal._RNvM*NtCs*_22cranpose_render_pixels12raster_sceneNt*11RasterScene4item* .text._RNvM*NtCs*_22cranpose_render_pixels12raster_sceneNt*11RasterScene4item*)
    *(.literal._RNvM*NtCs*_22cranpose_render_pixels12raster_sceneNt*11RasterScene6counts* .text._RNvM*NtCs*_22cranpose_render_pixels12raster_sceneNt*11RasterScene6counts*)
    *(.literal._RNvM*NtCs*_22cranpose_render_pixels12raster_sceneNt*8TextDraw11glyph_reach* .text._RNvM*NtCs*_22cranpose_render_pixels12raster_sceneNt*8TextDraw11glyph_reach*)
    *(.literal._RNvM*NtCs*_22cranpose_render_pixels7rewriteNt*7Rewrite17after_old_subtree* .text._RNvM*NtCs*_22cranpose_render_pixels7rewriteNt*7Rewrite17after_old_subtree*)
    *(.literal._RNvM*NtCs*_5alloc2rcINt*2RcDG0_INtNtNtCs*_4core3ops8function2FnTQL1_INtNtCs*_11cranpose_ui17subcompose_layout26SubcomposeMeasureScopeImplL0_ENtNtCs*_18cranpose_ui_layout11constraints11ConstraintsEEp6OutputNtNt*4core13MeasureResultEL_E9drop_slow* .text._RNvM*NtCs*_5alloc2rcINt*2RcDG0_INtNtNtCs*_4core3ops8function2FnTQL1_INtNtCs*_11cranpose_ui17subcompose_layout26SubcomposeMeasureScopeImplL0_ENtNtCs*_18cranpose_ui_layout11constraints11ConstraintsEEp6OutputNtNt*4core13MeasureResultEL_E9drop_slow*)
    *(.literal._RNvM*NtCs*_5alloc2rcINt*2RcINtCs*_8smallvec8SmallVecAI*DNtNtCs*_19cranpose_foundation8modifier18AnyModifierElementEL_Ej4_EE9drop_slow* .text._RNvM*NtCs*_5alloc2rcINt*2RcINtCs*_8smallvec8SmallVecAI*DNtNtCs*_19cranpose_foundation8modifier18AnyModifierElementEL_Ej4_EE9drop_slow*)
    *(.literal._RNvM*NtCs*_5alloc2rcINt*2RcNtNtCs*_11cranpose_ui23text_field_presentation17FieldPresentationE9drop_slow* .text._RNvM*NtCs*_5alloc2rcINt*2RcNtNtCs*_11cranpose_ui23text_field_presentation17FieldPresentationE9drop_slow*)
    *(.literal._RNvM*NtCs*_5alloc2rcINt*2RcNtNtCs*_11cranpose_ui6layout18LayoutBuilderStateE9drop_slow* .text._RNvM*NtCs*_5alloc2rcINt*2RcNtNtCs*_11cranpose_ui6layout18LayoutBuilderStateE9drop_slow*)
    *(.literal._RNvM*NtCs*_5alloc2rcINt*2RcNtNtCs*_13cranpose_text16annotated_string15AnnotatedStringE9drop_slow* .text._RNvM*NtCs*_5alloc2rcINt*2RcNtNtCs*_13cranpose_text16annotated_string15AnnotatedStringE9drop_slow*)
    *(.literal._RNvM*NtCs*_5alloc2rcINt*2RcNtNtNtCs*_11cranpose_ui4text7measure18PreparedTextLayoutE9drop_slow* .text._RNvM*NtCs*_5alloc2rcINt*2RcNtNtNtCs*_11cranpose_ui4text7measure18PreparedTextLayoutE9drop_slow*)
    *(.literal._RNvM*NtCs*_5alloc2rcINt*2RcNtNtNtCs*_11cranpose_ui8modifier5focus13FocusRestorerE9drop_slow* .text._RNvM*NtCs*_5alloc2rcINt*2RcNtNtNtCs*_11cranpose_ui8modifier5focus13FocusRestorerE9drop_slow*)
    *(.literal._RNvM*NtCs*_5alloc2rcINt*2RcNtNtNtCs*_13cranpose_core11snapshot_v211transparent34TransparentObserverMutableSnapshotE9drop_slow* .text._RNvM*NtCs*_5alloc2rcINt*2RcNtNtNtCs*_13cranpose_core11snapshot_v211transparent34TransparentObserverMutableSnapshotE9drop_slow*)
    *(.literal._RNvM*NtCs*_5alloc2rcINt*2RcNtNtNtCs*_13cranpose_core11snapshot_v26global14GlobalSnapshotE9drop_slow* .text._RNvM*NtCs*_5alloc2rcINt*2RcNtNtNtCs*_13cranpose_core11snapshot_v26global14GlobalSnapshotE9drop_slow*)
    *(.literal._RNvM*NtCs*_5alloc4syncINt*3ArcAfj14_E9drop_slow* .text._RNvM*NtCs*_5alloc4syncINt*3ArcAfj14_E9drop_slow*)
    *(.literal._RNvM*NtCs*_5alloc4syncINt*3ArcNtNtCs*_13cranpose_text11layout_body10LayoutBodyE9drop_slow* .text._RNvM*NtCs*_5alloc4syncINt*3ArcNtNtCs*_13cranpose_text11layout_body10LayoutBodyE9drop_slow*)
    *(.literal._RNvM*NtCs*_5alloc4syncINt*3ArcNtNtCs*_13cranpose_text16annotated_string12RenderStringE9drop_slow* .text._RNvM*NtCs*_5alloc4syncINt*3ArcNtNtCs*_13cranpose_text16annotated_string12RenderStringE9drop_slow*)
    *(.literal._RNvM*NtCs*_5alloc4syncINt*3ArcSNtNtCs*_13cranpose_text11laid_glyphs11PackedGlyphE9drop_slow* .text._RNvM*NtCs*_5alloc4syncINt*3ArcSNtNtCs*_13cranpose_text11laid_glyphs11PackedGlyphE9drop_slow*)
    *(.literal._RNvM*NtCs*_5alloc7raw_vecINt*6RawVecINtNtNtCs*_13cranpose_core7runtime10task_slots4SlotNt*9TaskEntryEE8grow_one* .text._RNvM*NtCs*_5alloc7raw_vecINt*6RawVecINtNtNtCs*_13cranpose_core7runtime10task_slots4SlotNt*9TaskEntryEE8grow_one*)
    *(.literal._RNvM*NtCs*_5alloc7raw_vecINt*6RawVecNtNtCs*_11cranpose_ui19selection_container10SelectableE8grow_one* .text._RNvM*NtCs*_5alloc7raw_vecINt*6RawVecNtNtCs*_11cranpose_ui19selection_container10SelectableE8grow_one*)
    *(.literal._RNvM*NtCs*_5alloc7raw_vecINt*6RawVecNtNtCs*_13cranpose_core8composer11ParentFrameE8grow_one* .text._RNvM*NtCs*_5alloc7raw_vecINt*6RawVecNtNtCs*_13cranpose_core8composer11ParentFrameE8grow_one*)
    *(.literal._RNvM*NtCs*_5alloc7raw_vecINt*6RawVecNtNtCs*_13cranpose_text11shaped_item5PieceE8grow_one* .text._RNvM*NtCs*_5alloc7raw_vecINt*6RawVecNtNtCs*_13cranpose_text11shaped_item5PieceE8grow_one*)
    *(.literal._RNvM*NtCs*_5alloc7raw_vecINt*6RawVecNtNtCs*_13cranpose_text12line_breaker16BreakOpportunityE8grow_one* .text._RNvM*NtCs*_5alloc7raw_vecINt*6RawVecNtNtCs*_13cranpose_text12line_breaker16BreakOpportunityE8grow_one*)
    *(.literal._RNvM*NtCs*_5alloc7raw_vecINt*6RawVecNtNtCs*_13cranpose_text6shaper11ShapingFaceE8grow_one* .text._RNvM*NtCs*_5alloc7raw_vecINt*6RawVecNtNtCs*_13cranpose_text6shaper11ShapingFaceE8grow_one*)
    *(.literal._RNvM*NtCs*_5alloc7raw_vecINt*6RawVecNtNtCs*_18cranpose_app_shell9inspector16InspectorControlE8grow_one* .text._RNvM*NtCs*_5alloc7raw_vecINt*6RawVecNtNtCs*_18cranpose_app_shell9inspector16InspectorControlE8grow_one*)
    *(.literal._RNvM*NtCs*_5alloc7raw_vecINt*6RawVecNtNtNtCs*_11cranpose_ui4text12layout_cache11DrawnLayoutE8grow_one* .text._RNvM*NtCs*_5alloc7raw_vecINt*6RawVecNtNtNtCs*_11cranpose_ui4text12layout_cache11DrawnLayoutE8grow_one*)
    *(.literal._RNvM*NtCs*_9hashbrown3mapINt*7HashMapNtCs*_13cranpose_core6NodeIduINtNtCs*_4core4hash18BuildHasherDefaultNtNtNt*11collections9word_hash10WordHasherEE6insert* .text._RNvM*NtCs*_9hashbrown3mapINt*7HashMapNtCs*_13cranpose_core6NodeIduINtNtCs*_4core4hash18BuildHasherDefaultNtNtNt*11collections9word_hash10WordHasherEE6insert*)
    *(.literal._RNvM*NtNtCs*_11cranpose_ui12render_state14dirty_node_setNt*12DirtyNodeSet21take_dirty_nodes_into* .text._RNvM*NtNtCs*_11cranpose_ui12render_state14dirty_node_setNt*12DirtyNodeSet21take_dirty_nodes_into*)
    *(.literal._RNvM*NtNtCs*_11cranpose_ui4text12layout_inputNt*12ShapingStyle4over* .text._RNvM*NtNtCs*_11cranpose_ui4text12layout_inputNt*12ShapingStyle4over*)
    *(.literal._RNvM*NtNtCs*_11cranpose_ui4text12layout_inputNt*14ParagraphSpans3new* .text._RNvM*NtNtCs*_11cranpose_ui4text12layout_inputNt*14ParagraphSpans3new*)
    *(.literal._RNvM*NtNtCs*_11cranpose_ui4text12layout_inputNt*14ParagraphSpans5spans* .text._RNvM*NtNtCs*_11cranpose_ui4text12layout_inputNt*14ParagraphSpans5spans*)
    *(.literal._RNvM*NtNtCs*_11cranpose_ui4text7measureNt*11TextService17begin_layout_pass* .text._RNvM*NtNtCs*_11cranpose_ui4text7measureNt*11TextService17begin_layout_pass*)
    *(.literal._RNvM*NtNtCs*_11cranpose_ui4text7measureNt*11TextService6layout* .text._RNvM*NtNtCs*_11cranpose_ui4text7measureNt*11TextService6layout*)
    *(.literal._RNvM*NtNtCs*_11cranpose_ui7widgets5popupNt*21HostedPopupRegistries16dismissable_open* .text._RNvM*NtNtCs*_11cranpose_ui7widgets5popupNt*21HostedPopupRegistries16dismissable_open*)
    *(.literal._RNvM*NtNtCs*_11cranpose_ui7widgets6layoutNt*17LayoutEnvironment7current* .text._RNvM*NtNtCs*_11cranpose_ui7widgets6layoutNt*17LayoutEnvironment7current*)
    *(.literal._RNvM*NtNtCs*_11cranpose_ui8modifier16coordinator_rectNt*15CoordinatorRect11placed_rect* .text._RNvM*NtNtCs*_11cranpose_ui8modifier16coordinator_rectNt*15CoordinatorRect11placed_rect*)
    *(.literal._RNvM*NtNtCs*_13cranpose_core11collections11bounded_lruINt*15BoundedLruCacheNtNtCs*_22cranpose_render_common10glyph_mask12GlyphMaskKeyINtNtCs*_4core6option6OptionNt*9GlyphMaskEE11link_newest* .text._RNvM*NtNtCs*_13cranpose_core11collections11bounded_lruINt*15BoundedLruCacheNtNtCs*_22cranpose_render_common10glyph_mask12GlyphMaskKeyINtNtCs*_4core6option6OptionNt*9GlyphMaskEE11link_newest*)
    *(.literal._RNvM*NtNtCs*_13cranpose_core11collections11bounded_lruINt*15BoundedLruCacheNtNtCs*_22cranpose_render_common10glyph_mask12GlyphMaskKeyINtNtCs*_4core6option6OptionNt*9GlyphMaskEE6unlink* .text._RNvM*NtNtCs*_13cranpose_core11collections11bounded_lruINt*15BoundedLruCacheNtNtCs*_22cranpose_render_common10glyph_mask12GlyphMaskKeyINtNtCs*_4core6option6OptionNt*9GlyphMaskEE6unlink*)
    *(.literal._RNvM*NtNtCs*_13cranpose_core11snapshot_v211transparentNt*34TransparentObserverMutableSnapshot11new_reusing* .text._RNvM*NtNtCs*_13cranpose_core11snapshot_v211transparentNt*34TransparentObserverMutableSnapshot11new_reusing*)
    *(.literal._RNvM*NtNtCs*_13cranpose_core11snapshot_v26globalNt*14GlobalSnapshot13get_or_create* .text._RNvM*NtNtCs*_13cranpose_core11snapshot_v26globalNt*14GlobalSnapshot13get_or_create*)
    *(.literal._RNvM*NtNtCs*_13cranpose_core5state12record_chainNt*11RecordChain17overwritable_head* .text._RNvM*NtNtCs*_13cranpose_core5state12record_chainNt*11RecordChain17overwritable_head*)
    *(.literal._RNvM*NtNtCs*_13cranpose_core5state12record_chainNt*11RecordChain4used* .text._RNvM*NtNtCs*_13cranpose_core5state12record_chainNt*11RecordChain4used*)
    *(.literal._RNvM*NtNtCs*_13cranpose_core5state12record_chainNt*11RecordChain8readable* .text._RNvM*NtNtCs*_13cranpose_core5state12record_chainNt*11RecordChain8readable*)
    *(.literal._RNvM*NtNtCs*_13cranpose_core8composer13runtime_stateNt*20ComposerRuntimeState20host_for_storage_key* .text._RNvM*NtNtCs*_13cranpose_core8composer13runtime_stateNt*20ComposerRuntimeState20host_for_storage_key*)
    *(.literal._RNvM*NtNtCs*_13cranpose_core8composer16composable_groupNt*8Composer26close_group_in_active_pass* .text._RNvM*NtNtCs*_13cranpose_core8composer16composable_groupNt*8Composer26close_group_in_active_pass*)
    *(.literal._RNvM*NtNtCs*_22cranpose_render_common13scene_builder18translate_geometryNt*17TranslateGeometry3new* .text._RNvM*NtNtCs*_22cranpose_render_common13scene_builder18translate_geometryNt*17TranslateGeometry3new*)
    *(.literal._RNvM*NtNtCs*_22cranpose_render_pixels4draw5reachNtNt*10scene_item7ItemRef6bounds* .text._RNvM*NtNtCs*_22cranpose_render_pixels4draw5reachNtNt*10scene_item7ItemRef6bounds*)
    *(.literal._RNvM*NtNtCs*_22cranpose_render_pixels4draw5reachNtNt*12raster_scene11RasterScene13covers_window* .text._RNvM*NtNtCs*_22cranpose_render_pixels4draw5reachNtNt*12raster_scene11RasterScene13covers_window*)
    *(.literal._RNvM*NtNtCs*_22cranpose_render_pixels4draw8row_runsNt*11RoundedFill3run* .text._RNvM*NtNtCs*_22cranpose_render_pixels4draw8row_runsNt*11RoundedFill3run*)
    *(.literal._RNvM*NtNtCs*_22cranpose_render_pixels8pipeline8in_placeNt*6Repush10visit_node* .text._RNvM*NtNtCs*_22cranpose_render_pixels8pipeline8in_placeNt*6Repush10visit_node*)
    *(.literal._RNvM*NtNtCs*_4core4cell4lazyINt*8LazyCellINtNtCs*_5alloc2rc2RcDNtNtCs*_13cranpose_core23snapshot_state_observer20ScopeChangedCallbackp6OutputuEL_ENCINvM**Nt*26SnapshotStateObserverInner13observe_readsNtNtNtCs*_11cranpose_ui12render_state16draw_observation20DrawObservationScopeuNCINv*18observe_draw_readsuNCNCNvNt*14modifier_nodes20observe_draw_command00Es_0*E0E11really_init* .text._RNvM*NtNtCs*_4core4cell4lazyINt*8LazyCellINtNtCs*_5alloc2rc2RcDNtNtCs*_13cranpose_core23snapshot_state_observer20ScopeChangedCallbackp6OutputuEL_ENCINvM**Nt*26SnapshotStateObserverInner13observe_readsNtNtNtCs*_11cranpose_ui12render_state16draw_observation20DrawObservationScopeuNCINv*18observe_draw_readsuNCNCNvNt*14modifier_nodes20observe_draw_command00Es_0*E0E11really_init*)
    *(.literal._RNvM*NtNtCs*_5alloc11collections9vec_dequeINt*8VecDequeINtNt*5boxed3BoxDINtNtNtCs*_4core3ops8function6FnOnceuEp6OutputuEL_EE4grow* .text._RNvM*NtNtCs*_5alloc11collections9vec_dequeINt*8VecDequeINtNt*5boxed3BoxDINtNtNtCs*_4core3ops8function6FnOnceuEp6OutputuEL_EE4grow*)
    *(.literal._RNvM*NtNtNtCs*_11cranpose_ui7widgets5nodes11layout_nodeNt*10LayoutNode24modifier_slices_snapshot* .text._RNvM*NtNtNtCs*_11cranpose_ui7widgets5nodes11layout_nodeNt*10LayoutNode24modifier_slices_snapshot*)
    *(.literal._RNvM*NtNtNtCs*_11cranpose_ui8modifier6slices8snapshotNt*14SlicesSnapshot3get* .text._RNvM*NtNtNtCs*_11cranpose_ui8modifier6slices8snapshotNt*14SlicesSnapshot3get*)
    *(.literal._RNvM*NtNtNtCs*_13cranpose_core4slot6writer5groupNtNt*5table16SlotWriteSession9end_group* .text._RNvM*NtNtNtCs*_13cranpose_core4slot6writer5groupNtNt*5table16SlotWriteSession9end_group*)
    *(.literal._RNvNtCs*_11cranpose_ui12render_state17app_context_by_id* .text._RNvNtCs*_11cranpose_ui12render_state17app_context_by_id*)
    *(.literal._RNvNtCs*_11cranpose_ui12render_state19current_app_context* .text._RNvNtCs*_11cranpose_ui12render_state19current_app_context*)
    *(.literal._RNvNtCs*_11cranpose_ui12render_state20schedule_draw_repass* .text._RNvNtCs*_11cranpose_ui12render_state20schedule_draw_repass*)
    *(.literal._RNvNtCs*_11cranpose_ui18text_modifier_node17shared_text_style* .text._RNvNtCs*_11cranpose_ui18text_modifier_node17shared_text_style*)
    *(.literal._RNvNtCs*_11cranpose_ui7density7density* .text._RNvNtCs*_11cranpose_ui7density7density*)
    *(.literal._RNvNtCs*_13cranpose_core11concurrency19next_alarm_deadline* .text._RNvNtCs*_13cranpose_core11concurrency19next_alarm_deadline*)
    *(.literal._RNvNtCs*_13cranpose_core11snapshot_v216current_snapshot* .text._RNvNtCs*_13cranpose_core11snapshot_v216current_snapshot*)
    *(.literal._RNvNtCs*_13cranpose_core11snapshot_v222notify_apply_observers* .text._RNvNtCs*_13cranpose_core11snapshot_v222notify_apply_observers*)
    *(.literal._RNvNtCs*_13cranpose_core11snapshot_v227current_snapshot_reads_into* .text._RNvNtCs*_13cranpose_core11snapshot_v227current_snapshot_reads_into*)
    *(.literal._RNvNtCs*_13cranpose_core12location_key13kept_constant* .text._RNvNtCs*_13cranpose_core12location_key13kept_constant*)
    *(.literal._RNvNtCs*_13cranpose_core16composer_context15replace_current* .text._RNvNtCs*_13cranpose_core16composer_context15replace_current*)
    *(.literal._RNvNtCs*_13cranpose_core16composer_context16current_composer* .text._RNvNtCs*_13cranpose_core16composer_context16current_composer*)
    *(.literal._RNvNtCs*_13cranpose_core16snapshot_pinning22lowest_pinned_snapshot* .text._RNvNtCs*_13cranpose_core16snapshot_pinning22lowest_pinned_snapshot*)
    *(.literal._RNvNtCs*_13cranpose_core8composer25close_scoped_branch_group* .text._RNvNtCs*_13cranpose_core8composer25close_scoped_branch_group*)
    *(.literal._RNvNtCs*_13cranpose_text11shaped_item10face_index* .text._RNvNtCs*_13cranpose_text11shaped_item10face_index*)
    *(.literal._RNvNtCs*_13cranpose_text12line_breaker14has_hard_break* .text._RNvNtCs*_13cranpose_text12line_breaker14has_hard_break*)
    *(.literal._RNvNtCs*_13cranpose_text16annotated_string16render_hash_impl* .text._RNvNtCs*_13cranpose_text16annotated_string16render_hash_impl*)
    *(.literal._RNvNtCs*_20cranpose_ui_graphics15layer_transform19apply_layer_to_quad* .text._RNvNtCs*_20cranpose_ui_graphics15layer_transform19apply_layer_to_quad*)
    *(.literal._RNvNtCs*_22cranpose_render_common11text_raster10paint_text* .text._RNvNtCs*_22cranpose_render_common11text_raster10paint_text*)
    *(.literal._RNvNtCs*_22cranpose_render_common11text_raster12paint_glyphs* .text._RNvNtCs*_22cranpose_render_common11text_raster12paint_glyphs*)
    *(.literal._RNvNtCs*_22cranpose_render_common12style_shared20apply_paint_to_color* .text._RNvNtCs*_22cranpose_render_common12style_shared20apply_paint_to_color*)
    *(.literal._RNvNtCs*_22cranpose_render_common14primitive_emit23round_rect_shape_params* .text._RNvNtCs*_22cranpose_render_common14primitive_emit23round_rect_shape_params*)
    *(.literal._RNvNtCs*_22cranpose_render_common15layer_recycling10boxed_text* .text._RNvNtCs*_22cranpose_render_common15layer_recycling10boxed_text*)
    *(.literal._RNvNtCs*_22cranpose_render_common15layer_recycling15recycle_lowered* .text._RNvNtCs*_22cranpose_render_common15layer_recycling15recycle_lowered*)
    *(.literal._RNvNtCs*_22cranpose_render_pixels4draw11place_shape* .text._RNvNtCs*_22cranpose_render_pixels4draw11place_shape*)
    *(.literal._RNvNtCs*_22cranpose_render_pixels4draw18opaque_solid_bytes* .text._RNvNtCs*_22cranpose_render_pixels4draw18opaque_solid_bytes*)
    *(.literal._RNvNtCs*_22cranpose_render_pixels4draw19clip_rect_to_window* .text._RNvNtCs*_22cranpose_render_pixels4draw19clip_rect_to_window*)
    *(.literal._RNvNtCs*_22cranpose_render_pixels6damage16add_changed_pair* .text._RNvNtCs*_22cranpose_render_pixels6damage16add_changed_pair*)
    *(.literal._RNvNtCs*_22cranpose_render_pixels6damage8add_area* .text._RNvNtCs*_22cranpose_render_pixels6damage8add_area*)
    *(.literal._RNvNtCs*_22cranpose_render_pixels8pipeline25populate_draws_from_graph* .text._RNvNtCs*_22cranpose_render_pixels8pipeline25populate_draws_from_graph*)
    *(.literal._RNvNtNtCs*_11cranpose_ui4text7measure14prepare_shared* .text._RNvNtNtCs*_11cranpose_ui4text7measure14prepare_shared*)
    *(.literal._RNvNtNtCs*_11cranpose_ui8modifier7z_index14z_index_in_use* .text._RNvNtNtCs*_11cranpose_ui8modifier7z_index14z_index_in_use*)
    *(.literal._RNvNtNtCs*_13cranpose_core5state15readable_record35readable_record_for_active_snapshot* .text._RNvNtNtCs*_13cranpose_core5state15readable_record35readable_record_for_active_snapshot*)
    *(.literal._RNvNtNtCs*_18cranpose_app_shell11shell_frame12layout_phase20pending_repass_nodes* .text._RNvNtNtCs*_18cranpose_app_shell11shell_frame12layout_phase20pending_repass_nodes*)
    *(.literal._RNvNtNtCs*_19cranpose_foundation8modifier5chain21update_entry_in_place* .text._RNvNtNtCs*_19cranpose_foundation8modifier5chain21update_entry_in_place*)
    *(.literal._RNvNtNtCs*_19cranpose_foundation8modifier5chain33request_update_auto_invalidations* .text._RNvNtNtCs*_19cranpose_foundation8modifier5chain33request_update_auto_invalidations*)
    *(.literal._RNvNtNtCs*_20cranpose_ui_graphics6record11materialize17materialize_shape* .text._RNvNtNtCs*_20cranpose_ui_graphics6record11materialize17materialize_shape*)
    *(.literal._RNvNtNtCs*_22cranpose_render_common13scene_builder10node_layer16children_context* .text._RNvNtNtCs*_22cranpose_render_common13scene_builder10node_layer16children_context*)
    *(.literal._RNvNtNtCs*_22cranpose_render_common13scene_builder11inline_leaf18lower_placed_child* .text._RNvNtNtCs*_22cranpose_render_common13scene_builder11inline_leaf18lower_placed_child*)
    *(.literal._RNvNtNtCs*_22cranpose_render_common13scene_builder14draw_recording17append_draw_nodes* .text._RNvNtNtCs*_22cranpose_render_common13scene_builder14draw_recording17append_draw_nodes*)
    *(.literal._RNvNtNtCs*_22cranpose_render_common13scene_builder9text_node20text_node_from_parts* .text._RNvNtNtCs*_22cranpose_render_common13scene_builder9text_node20text_node_from_parts*)
    *(.literal._RNvNtNtCs*_22cranpose_render_pixels4draw4text16text_raster_rect* .text._RNvNtNtCs*_22cranpose_render_pixels4draw4text16text_raster_rect*)
    *(.literal._RNvNtNtCs*_22cranpose_render_pixels4draw5reach11text_bounds* .text._RNvNtNtCs*_22cranpose_render_pixels4draw5reach11text_bounds*)
    *(.literal._RNvNtNtCs*_22cranpose_render_pixels8pipeline10draw_child17render_draw_child* .text._RNvNtNtCs*_22cranpose_render_pixels8pipeline10draw_child17render_draw_child*)
    *(.literal._RNvX*Cs*_20cranpose_runtime_stdNt*12StdSchedulerNtNtCs*_13cranpose_core8platform16RuntimeScheduler14schedule_frame* .text._RNvX*Cs*_20cranpose_runtime_stdNt*12StdSchedulerNtNtCs*_13cranpose_core8platform16RuntimeScheduler14schedule_frame*)
    *(.literal._RNvX*Cs*_22cranpose_render_pixelsNt*14PixelsRendererNtCs*_22cranpose_render_common8Renderer25update_scene_from_applier* .text._RNvX*Cs*_22cranpose_render_pixelsNt*14PixelsRendererNtCs*_22cranpose_render_common8Renderer25update_scene_from_applier*)
    *(.literal._RNvX*NtCs*_11cranpose_ui12render_stateNt*15AppContextScopeNtNtNtCs*_4core3ops4drop4Drop4drop* .text._RNvX*NtCs*_11cranpose_ui12render_stateNt*15AppContextScopeNtNtNtCs*_4core3ops4drop4Drop4drop*)
    *(.literal._RNvX*NtCs*_11cranpose_ui14modifier_nodesNt*14BackgroundNodeNtNtCs*_19cranpose_foundation8modifier15DelegatableNode10node_state* .text._RNvX*NtCs*_11cranpose_ui14modifier_nodesNt*14BackgroundNodeNtNtCs*_19cranpose_foundation8modifier15DelegatableNode10node_state*)
    *(.literal._RNvX*NtCs*_11cranpose_ui14modifier_nodesNt*15DrawCommandNodeNtNtCs*_19cranpose_foundation8modifier15DelegatableNode10node_state* .text._RNvX*NtCs*_11cranpose_ui14modifier_nodesNt*15DrawCommandNodeNtNtCs*_19cranpose_foundation8modifier15DelegatableNode10node_state*)
    *(.literal._RNvX*NtCs*_11cranpose_ui14modifier_nodesNt*22WindowRectReporterNodeNtNtCs*_19cranpose_foundation8modifier12ModifierNode18as_layout_node_mut* .text._RNvX*NtCs*_11cranpose_ui14modifier_nodesNt*22WindowRectReporterNodeNtNtCs*_19cranpose_foundation8modifier12ModifierNode18as_layout_node_mut*)
    *(.literal._RNvX*NtCs*_11cranpose_ui14modifier_nodesNt*8SizeNodeNtNtCs*_19cranpose_foundation8modifier15DelegatableNode10node_state* .text._RNvX*NtCs*_11cranpose_ui14modifier_nodesNt*8SizeNodeNtNtCs*_19cranpose_foundation8modifier15DelegatableNode10node_state*)
    *(.literal._RNvX*NtCs*_11cranpose_ui17subcompose_layoutNt*20SubcomposeLayoutNodeNtNtCs*_13cranpose_core4node4Node13needs_measure* .text._RNvX*NtCs*_11cranpose_ui17subcompose_layoutNt*20SubcomposeLayoutNodeNtNtCs*_13cranpose_core4node4Node13needs_measure*)
    *(.literal._RNvX*NtCs*_11cranpose_ui17subcompose_layoutNt*20SubcomposeLayoutNodeNtNtCs*_13cranpose_core4node4Node21on_attached_to_parent* .text._RNvX*NtCs*_11cranpose_ui17subcompose_layoutNt*20SubcomposeLayoutNodeNtNtCs*_13cranpose_core4node4Node21on_attached_to_parent*)
    *(.literal._RNvX*NtCs*_11cranpose_ui17subcompose_layoutNt*20SubcomposeLayoutNodeNtNtCs*_13cranpose_core4node4Node6parent* .text._RNvX*NtCs*_11cranpose_ui17subcompose_layoutNt*20SubcomposeLayoutNodeNtNtCs*_13cranpose_core4node4Node6parent*)
    *(.literal._RNvX*NtCs*_11cranpose_ui18text_modifier_nodeNt*16TextModifierNodeNtNtCs*_19cranpose_foundation8modifier12ModifierNode16as_draw_node_mut* .text._RNvX*NtCs*_11cranpose_ui18text_modifier_nodeNt*16TextModifierNodeNtNtCs*_19cranpose_foundation8modifier12ModifierNode16as_draw_node_mut*)
    *(.literal._RNvX*NtCs*_11cranpose_ui18text_modifier_nodeNt*16TextModifierNodeNtNtCs*_19cranpose_foundation8modifier12ModifierNode17as_semantics_node* .text._RNvX*NtCs*_11cranpose_ui18text_modifier_nodeNt*16TextModifierNodeNtNtCs*_19cranpose_foundation8modifier12ModifierNode17as_semantics_node*)
    *(.literal._RNvX*NtCs*_11cranpose_ui18text_modifier_nodeNt*16TextModifierNodeNtNtCs*_19cranpose_foundation8modifier12ModifierNode18as_layout_node_mut* .text._RNvX*NtCs*_11cranpose_ui18text_modifier_nodeNt*16TextModifierNodeNtNtCs*_19cranpose_foundation8modifier12ModifierNode18as_layout_node_mut*)
    *(.literal._RNvX*NtCs*_11cranpose_ui18text_modifier_nodeNt*16TextModifierNodeNtNtCs*_19cranpose_foundation8modifier18LayoutModifierNode7measure* .text._RNvX*NtCs*_11cranpose_ui18text_modifier_nodeNt*16TextModifierNodeNtNtCs*_19cranpose_foundation8modifier18LayoutModifierNode7measure*)
    *(.literal._RNvX*NtCs*_11cranpose_ui7densityNt*19DensityMeasureScopeNtNtCs*_18cranpose_ui_layout4core12MeasureScope10font_scale* .text._RNvX*NtCs*_11cranpose_ui7densityNt*19DensityMeasureScopeNtNtCs*_18cranpose_ui_layout4core12MeasureScope10font_scale*)
    *(.literal._RNvX*NtCs*_13cranpose_core11snapshot_v2Nt*20CurrentSnapshotGuardNtNtNtCs*_4core3ops4drop4Drop4drop* .text._RNvX*NtCs*_13cranpose_core11snapshot_v2Nt*20CurrentSnapshotGuardNtNtNtCs*_4core3ops4drop4Drop4drop*)
    *(.literal._RNvX*NtCs*_13cranpose_core5stateINt*10TypedWritefENt*12PendingWrite7matches* .text._RNvX*NtCs*_13cranpose_core5stateINt*10TypedWritefENt*12PendingWrite7matches*)
    *(.literal._RNvX*NtCs*_13cranpose_core5stateINt*10TypedWritefENt*12PendingWrite7written* .text._RNvX*NtCs*_13cranpose_core5stateINt*10TypedWritefENt*12PendingWrite7written*)
    *(.literal._RNvX*NtCs*_13cranpose_core5stateINt*20SnapshotMutableStateINtNtCs*_4core6option6OptionNtNtCs*_11cranpose_ui12focus_within16FocusWithinChainEENt*11StateObject17observation_lease* .text._RNvX*NtCs*_13cranpose_core5stateINt*20SnapshotMutableStateINtNtCs*_4core6option6OptionNtNtCs*_11cranpose_ui12focus_within16FocusWithinChainEENt*11StateObject17observation_lease*)
    *(.literal._RNvX*NtCs*_13cranpose_core5stateINt*20SnapshotMutableStateINtNtCs*_4core6option6OptionNtNtCs*_11cranpose_ui12focus_within16FocusWithinChainEENt*11StateObject24overwrite_unused_records* .text._RNvX*NtCs*_13cranpose_core5stateINt*20SnapshotMutableStateINtNtCs*_4core6option6OptionNtNtCs*_11cranpose_ui12focus_within16FocusWithinChainEENt*11StateObject24overwrite_unused_records*)
    *(.literal._RNvX*NtCs*_13cranpose_core5stateINt*20SnapshotMutableStateINtNtCs*_4core6option6OptionNtNtCs*_11cranpose_ui13nested_scroll18NestedScrollParentEENt*11StateObject9object_id* .text._RNvX*NtCs*_13cranpose_core5stateINt*20SnapshotMutableStateINtNtCs*_4core6option6OptionNtNtCs*_11cranpose_ui13nested_scroll18NestedScrollParentEENt*11StateObject9object_id*)
    *(.literal._RNvX*NtCs*_13cranpose_core5stateINt*20SnapshotMutableStateNtNtNtCs*_19cranpose_foundation4lazy15lazy_list_state15LazyLayoutStatsENt*11StateObject6as_any* .text._RNvX*NtCs*_13cranpose_core5stateINt*20SnapshotMutableStateNtNtNtCs*_19cranpose_foundation4lazy15lazy_list_state15LazyLayoutStatsENt*11StateObject6as_any*)
    *(.literal._RNvX*NtCs*_13cranpose_core5stateINt*20SnapshotMutableStatefENt*11StateObject6as_any* .text._RNvX*NtCs*_13cranpose_core5stateINt*20SnapshotMutableStatefENt*11StateObject6as_any*)
    *(.literal._RNvX*NtCs*_13cranpose_core5stateINtNtCs*_4core6option6OptionNtNtCs*_11cranpose_ui11interaction11InteractionENt*11RecordValue15holds_resources* .text._RNvX*NtCs*_13cranpose_core5stateINtNtCs*_4core6option6OptionNtNtCs*_11cranpose_ui11interaction11InteractionENt*11RecordValue15holds_resources*)
    *(.literal._RNvX*NtCs*_13cranpose_core5stateNt*15StructuralEqualINt*14MutationPolicybE10equivalent* .text._RNvX*NtCs*_13cranpose_core5stateNt*15StructuralEqualINt*14MutationPolicybE10equivalent*)
    *(.literal._RNvX*NtCs*_13cranpose_core5stateNt*15StructuralEqualINt*14MutationPolicyfE10equivalent* .text._RNvX*NtCs*_13cranpose_core5stateNt*15StructuralEqualINt*14MutationPolicyfE10equivalent*)
    *(.literal._RNvX*NtCs*_13cranpose_core7runtimeNt*18StateTeardownScopeNtNtNtCs*_4core3ops4drop4Drop4drop* .text._RNvX*NtCs*_13cranpose_core7runtimeNt*18StateTeardownScopeNtNtNtCs*_4core3ops4drop4Drop4drop*)
    *(.literal._RNvX*NtCs*_13cranpose_core8composerNt*20SubcomposeStackGuardNtNtNtCs*_4core3ops4drop4Drop4drop* .text._RNvX*NtCs*_13cranpose_core8composerNt*20SubcomposeStackGuardNtNtNtCs*_4core3ops4drop4Drop4drop*)
    *(.literal._RNvX*NtCs*_13cranpose_text5styleNt*14ParagraphStyleNtNtCs*_4core3cmp9PartialEq2eq* .text._RNvX*NtCs*_13cranpose_text5styleNt*14ParagraphStyleNtNtCs*_4core3cmp9PartialEq2eq*)
    *(.literal._RNvX*NtCs*_18cranpose_animation9animationINt*24TransitionAnimationStatefENt*27InfiniteTransitionAnimation15has_subscribers* .text._RNvX*NtCs*_18cranpose_animation9animationINt*24TransitionAnimationStatefENt*27InfiniteTransitionAnimation15has_subscribers*)
    *(.literal._RNvX*NtCs*_18cranpose_ui_layout4coreNt*10ParentDataNtNtCs*_4core3cmp9PartialEq2eq* .text._RNvX*NtCs*_18cranpose_ui_layout4coreNt*10ParentDataNtNtCs*_4core3cmp9PartialEq2eq*)
    *(.literal._RNvX*NtCs*_19cranpose_foundation8modifierINt*20TypedModifierElementINtNtCs*_11cranpose_ui11interaction18InteractionElementNt*12PressTrackerEENt*18AnyModifierElement12capabilities* .text._RNvX*NtCs*_19cranpose_foundation8modifierINt*20TypedModifierElementINtNtCs*_11cranpose_ui11interaction18InteractionElementNt*12PressTrackerEENt*18AnyModifierElement12capabilities*)
    *(.literal._RNvX*NtCs*_19cranpose_foundation8modifierINt*20TypedModifierElementNtNtCs*_11cranpose_ui14modifier_nodes11FillElementENt*18AnyModifierElement15requires_update* .text._RNvX*NtCs*_19cranpose_foundation8modifierINt*20TypedModifierElementNtNtCs*_11cranpose_ui14modifier_nodes11FillElementENt*18AnyModifierElement15requires_update*)
    *(.literal._RNvX*NtCs*_19cranpose_foundation8modifierINt*20TypedModifierElementNtNtCs*_11cranpose_ui14modifier_nodes11FillElementENt*18AnyModifierElement3key* .text._RNvX*NtCs*_19cranpose_foundation8modifierINt*20TypedModifierElementNtNtCs*_11cranpose_ui14modifier_nodes11FillElementENt*18AnyModifierElement3key*)
    *(.literal._RNvX*NtCs*_19cranpose_foundation8modifierINt*20TypedModifierElementNtNtCs*_11cranpose_ui14modifier_nodes11SizeElementENt*18AnyModifierElement14inspector_name* .text._RNvX*NtCs*_19cranpose_foundation8modifierINt*20TypedModifierElementNtNtCs*_11cranpose_ui14modifier_nodes11SizeElementENt*18AnyModifierElement14inspector_name*)
    *(.literal._RNvX*NtCs*_19cranpose_foundation8modifierINt*20TypedModifierElementNtNtCs*_11cranpose_ui14modifier_nodes13WeightElementENt*18AnyModifierElement14inspector_name* .text._RNvX*NtCs*_19cranpose_foundation8modifierINt*20TypedModifierElementNtNtCs*_11cranpose_ui14modifier_nodes13WeightElementENt*18AnyModifierElement14inspector_name*)
    *(.literal._RNvX*NtCs*_19cranpose_foundation8modifierINt*20TypedModifierElementNtNtCs*_11cranpose_ui14modifier_nodes18CornerShapeElementENt*18AnyModifierElement6as_any* .text._RNvX*NtCs*_19cranpose_foundation8modifierINt*20TypedModifierElementNtNtCs*_11cranpose_ui14modifier_nodes18CornerShapeElementENt*18AnyModifierElement6as_any*)
    *(.literal._RNvX*NtCs*_19cranpose_foundation8modifierINt*20TypedModifierElementNtNtCs*_11cranpose_ui18text_modifier_node19TextModifierElementENt*18AnyModifierElement11update_node* .text._RNvX*NtCs*_19cranpose_foundation8modifierINt*20TypedModifierElementNtNtCs*_11cranpose_ui18text_modifier_node19TextModifierElementENt*18AnyModifierElement11update_node*)
    *(.literal._RNvX*NtCs*_19cranpose_foundation8modifierINt*20TypedModifierElementNtNtCs*_11cranpose_ui18text_modifier_node19TextModifierElementENt*18AnyModifierElement12capabilities* .text._RNvX*NtCs*_19cranpose_foundation8modifierINt*20TypedModifierElementNtNtCs*_11cranpose_ui18text_modifier_node19TextModifierElementENt*18AnyModifierElement12capabilities*)
    *(.literal._RNvX*NtCs*_19cranpose_foundation8modifierINt*20TypedModifierElementNtNtCs*_11cranpose_ui18text_modifier_node19TextModifierElementENt*18AnyModifierElement14inspector_name* .text._RNvX*NtCs*_19cranpose_foundation8modifierINt*20TypedModifierElementNtNtCs*_11cranpose_ui18text_modifier_node19TextModifierElementENt*18AnyModifierElement14inspector_name*)
    *(.literal._RNvX*NtCs*_19cranpose_foundation8modifierINt*20TypedModifierElementNtNtCs*_11cranpose_ui18text_modifier_node19TextModifierElementENt*18AnyModifierElement15can_update_node* .text._RNvX*NtCs*_19cranpose_foundation8modifierINt*20TypedModifierElementNtNtCs*_11cranpose_ui18text_modifier_node19TextModifierElementENt*18AnyModifierElement15can_update_node*)
    *(.literal._RNvX*NtCs*_19cranpose_foundation8modifierINt*20TypedModifierElementNtNtCs*_11cranpose_ui18text_modifier_node19TextModifierElementENt*18AnyModifierElement6as_any* .text._RNvX*NtCs*_19cranpose_foundation8modifierINt*20TypedModifierElementNtNtCs*_11cranpose_ui18text_modifier_node19TextModifierElementENt*18AnyModifierElement6as_any*)
    *(.literal._RNvX*NtCs*_19cranpose_foundation8modifierNt*24BasicModifierNodeContextNt*19ModifierNodeContext10invalidate* .text._RNvX*NtCs*_19cranpose_foundation8modifierNt*24BasicModifierNodeContextNt*19ModifierNodeContext10invalidate*)
    *(.literal._RNvX*NtCs*_22cranpose_render_pixels12raster_sceneNt*7OutlineNtNtCs*_4core3cmp9PartialEq2eq* .text._RNvX*NtCs*_22cranpose_render_pixels12raster_sceneNt*7OutlineNtNtCs*_4core3cmp9PartialEq2eq*)
    *(.literal._RNvX*NtCs*_25cranpose_platform_esp_idf5touchNt*7NoTouchNt*5Touch4read* .text._RNvX*NtCs*_25cranpose_platform_esp_idf5touchNt*7NoTouchNt*5Touch4read*)
    *(.literal._RNvX*NtCs*_4core3anyINtNt*4cell7RefCellNtNtNtCs*_19cranpose_foundation4lazy15lazy_list_state18LazyListStateInnerENt*3Any7type_id* .text._RNvX*NtCs*_4core3anyINtNt*4cell7RefCellNtNtNtCs*_19cranpose_foundation4lazy15lazy_list_state18LazyListStateInnerENt*3Any7type_id*)
    *(.literal._RNvX*NtCs*_4core3anyINtNt*4cell7RefCellNtNtNtNtCs*_19cranpose_foundation4lazy15lazy_list_state15scroll_position19ScrollPositionInnerENt*3Any7type_id* .text._RNvX*NtCs*_4core3anyINtNt*4cell7RefCellNtNtNtNtCs*_19cranpose_foundation4lazy15lazy_list_state15scroll_position19ScrollPositionInnerENt*3Any7type_id*)
    *(.literal._RNvX*NtCs*_4core3anyINtNtNtCs*_13cranpose_core7runtime11state_arena14TypedStateCellNtNtNtCs*_19cranpose_foundation4lazy15lazy_list_state15LazyLayoutStatsENt*3Any7type_id* .text._RNvX*NtCs*_4core3anyINtNtNtCs*_13cranpose_core7runtime11state_arena14TypedStateCellNtNtNtCs*_19cranpose_foundation4lazy15lazy_list_state15LazyLayoutStatsENt*3Any7type_id*)
    *(.literal._RNvX*NtCs*_4core3anyINtNtNtCs*_13cranpose_core7runtime11state_arena14TypedStateCellfENt*3Any7type_id* .text._RNvX*NtCs*_4core3anyINtNtNtCs*_13cranpose_core7runtime11state_arena14TypedStateCellfENt*3Any7type_id*)
    *(.literal._RNvX*NtCs*_4core3anyNCNCINvM*NtCs*_13cranpose_core23snapshot_state_observerNt*26SnapshotStateObserverInner13observe_readsNtNtNtCs*_11cranpose_ui12render_state16draw_observation20DrawObservationScopeuNCINv*18observe_draw_readsuNCNCNvNt*14modifier_nodes20observe_draw_command00Es_0*E00Nt*3Any7type_id* .text._RNvX*NtCs*_4core3anyNCNCINvM*NtCs*_13cranpose_core23snapshot_state_observerNt*26SnapshotStateObserverInner13observe_readsNtNtNtCs*_11cranpose_ui12render_state16draw_observation20DrawObservationScopeuNCINv*18observe_draw_readsuNCNCNvNt*14modifier_nodes20observe_draw_command00Es_0*E00Nt*3Any7type_id*)
    *(.literal._RNvX*NtCs*_4core3anyNtNtCs*_11cranpose_ui14modifier_nodes8FillNodeNt*3Any7type_id* .text._RNvX*NtCs*_4core3anyNtNtCs*_11cranpose_ui14modifier_nodes8FillNodeNt*3Any7type_id*)
    *(.literal._RNvX*NtCs*_4core3anyNtNtCs*_11cranpose_ui17subcompose_layout20SubcomposeLayoutNodeNt*3Any7type_id* .text._RNvX*NtCs*_4core3anyNtNtCs*_11cranpose_ui17subcompose_layout20SubcomposeLayoutNodeNt*3Any7type_id*)
    *(.literal._RNvX*NtCs*_4core3anyNtNtCs*_11cranpose_ui18text_modifier_node16TextModifierNodeNt*3Any7type_id* .text._RNvX*NtCs*_4core3anyNtNtCs*_11cranpose_ui18text_modifier_node16TextModifierNodeNt*3Any7type_id*)
    *(.literal._RNvX*NtCs*_4core3anyNtNtCs*_11cranpose_ui8modifier8ModifierNt*3Any7type_id* .text._RNvX*NtCs*_4core3anyNtNtCs*_11cranpose_ui8modifier8ModifierNt*3Any7type_id*)
    *(.literal._RNvX*NtCs*_4core3anyNtNtNtCs*_11cranpose_ui12render_state16draw_observation20DrawObservationScopeNt*3Any7type_id* .text._RNvX*NtCs*_4core3anyNtNtNtCs*_11cranpose_ui12render_state16draw_observation20DrawObservationScopeNt*3Any7type_id*)
    *(.literal._RNvX*NtCs*_4core3anyNtNtNtNtCs*_11cranpose_ui7widgets5nodes11layout_node10LayoutNodeNt*3Any7type_id* .text._RNvX*NtCs*_4core3anyNtNtNtNtCs*_11cranpose_ui7widgets5nodes11layout_node10LayoutNodeNt*3Any7type_id*)
    *(.literal._RNvX*NtCs*_4core3anyfNt*3Any7type_id* .text._RNvX*NtCs*_4core3anyfNt*3Any7type_id*)
    *(.literal._RNvX*NtNtCs*_11cranpose_ui14modifier_nodes9clickableNt*13ClickableNodeNtNtCs*_19cranpose_foundation8modifier12ModifierNode25as_pointer_input_node_mut* .text._RNvX*NtNtCs*_11cranpose_ui14modifier_nodes9clickableNt*13ClickableNodeNtNtCs*_19cranpose_foundation8modifier12ModifierNode25as_pointer_input_node_mut*)
    *(.literal._RNvX*NtNtCs*_11cranpose_ui7widgets6layoutNtNtNtNt*6layout8policies20empty_measure_policy18EmptyMeasurePolicyNt*12PolicyUpdate6update* .text._RNvX*NtNtCs*_11cranpose_ui7widgets6layoutNtNtNtNt*6layout8policies20empty_measure_policy18EmptyMeasurePolicyNt*12PolicyUpdate6update*)
    *(.literal._RNvX*NtNtCs*_11cranpose_ui7widgets6layoutNtNtNtNt*6layout8policies20empty_measure_policy18EmptyMeasurePolicyNt*12PolicyUpdate8new_node* .text._RNvX*NtNtCs*_11cranpose_ui7widgets6layoutNtNtNtNt*6layout8policies20empty_measure_policy18EmptyMeasurePolicyNt*12PolicyUpdate8new_node*)
    *(.literal._RNvX*NtNtCs*_13cranpose_core14memory_applier12applier_implNt*13MemoryApplierNtNt*7applier7Applier16end_bubble_batch* .text._RNvX*NtNtCs*_13cranpose_core14memory_applier12applier_implNt*13MemoryApplierNtNt*7applier7Applier16end_bubble_batch*)
    *(.literal._RNvX*NtNtCs*_13cranpose_core14memory_applier12applier_implNt*13MemoryApplierNtNt*7applier7Applier16note_layout_dirt* .text._RNvX*NtNtCs*_13cranpose_core14memory_applier12applier_implNt*13MemoryApplierNtNt*7applier7Applier16note_layout_dirt*)
    *(.literal._RNvX*NtNtCs*_13cranpose_core14memory_applier12applier_implNt*13MemoryApplierNtNt*7applier7Applier18begin_bubble_batch* .text._RNvX*NtNtCs*_13cranpose_core14memory_applier12applier_implNt*13MemoryApplierNtNt*7applier7Applier18begin_bubble_batch*)
    *(.literal._RNvX*NtNtCs*_13cranpose_core8composer16composable_groupNt*15ComposableGroupNtNtNtCs*_4core3ops4drop4Drop4drop* .text._RNvX*NtNtCs*_13cranpose_core8composer16composable_groupNt*15ComposableGroupNtNtNtCs*_4core3ops4drop4Drop4drop*)
    *(.literal._RNvX*NtNtNtCs*_11cranpose_ui7widgets5nodes11layout_nodeNt*10LayoutNodeNtNtCs*_13cranpose_core4node4Node13needs_measure* .text._RNvX*NtNtNtCs*_11cranpose_ui7widgets5nodes11layout_nodeNt*10LayoutNodeNtNtCs*_13cranpose_core4node4Node13needs_measure*)
    *(.literal._RNvX*NtNtNtCs*_11cranpose_ui7widgets5nodes11layout_nodeNt*10LayoutNodeNtNtCs*_13cranpose_core4node4Node17mark_needs_layout* .text._RNvX*NtNtNtCs*_11cranpose_ui7widgets5nodes11layout_nodeNt*10LayoutNodeNtNtCs*_13cranpose_core4node4Node17mark_needs_layout*)
    *(.literal._RNvX*NtNtNtCs*_11cranpose_ui7widgets5nodes11layout_nodeNt*10LayoutNodeNtNtCs*_13cranpose_core4node4Node17owned_child_index* .text._RNvX*NtNtNtCs*_11cranpose_ui7widgets5nodes11layout_nodeNt*10LayoutNodeNtNtCs*_13cranpose_core4node4Node17owned_child_index*)
    *(.literal._RNvX*NtNtNtCs*_11cranpose_ui7widgets5nodes11layout_nodeNt*10LayoutNodeNtNtCs*_13cranpose_core4node4Node18mark_needs_measure* .text._RNvX*NtNtNtCs*_11cranpose_ui7widgets5nodes11layout_nodeNt*10LayoutNodeNtNtCs*_13cranpose_core4node4Node18mark_needs_measure*)
    *(.literal._RNvX*NtNtNtCs*_11cranpose_ui7widgets5nodes11layout_nodeNt*10LayoutNodeNtNtCs*_13cranpose_core4node4Node21collect_children_into* .text._RNvX*NtNtNtCs*_11cranpose_ui7widgets5nodes11layout_nodeNt*10LayoutNodeNtNtCs*_13cranpose_core4node4Node21collect_children_into*)
    *(.literal._RNvX*NtNtNtCs*_11cranpose_ui7widgets5nodes11layout_nodeNt*10LayoutNodeNtNtCs*_13cranpose_core4node4Node22on_removed_from_parent* .text._RNvX*NtNtNtCs*_11cranpose_ui7widgets5nodes11layout_nodeNt*10LayoutNodeNtNtCs*_13cranpose_core4node4Node22on_removed_from_parent*)
    *(.literal._RNvX*NtNtNtCs*_11cranpose_ui7widgets5nodes11layout_nodeNt*10LayoutNodeNtNtCs*_13cranpose_core4node4Node23descendant_needs_layout* .text._RNvX*NtNtNtCs*_11cranpose_ui7widgets5nodes11layout_nodeNt*10LayoutNodeNtNtCs*_13cranpose_core4node4Node23descendant_needs_layout*)
    *(.literal._RNvX*NtNtNtCs*_11cranpose_ui7widgets5nodes11layout_nodeNt*10LayoutNodeNtNtCs*_13cranpose_core4node4Node24descendant_needs_measure* .text._RNvX*NtNtNtCs*_11cranpose_ui7widgets5nodes11layout_nodeNt*10LayoutNodeNtNtCs*_13cranpose_core4node4Node24descendant_needs_measure*)
    *(.literal._RNvX*NtNtNtCs*_11cranpose_ui7widgets5nodes11layout_nodeNt*10LayoutNodeNtNtCs*_13cranpose_core4node4Node6parent* .text._RNvX*NtNtNtCs*_11cranpose_ui7widgets5nodes11layout_nodeNt*10LayoutNodeNtNtCs*_13cranpose_core4node4Node6parent*)
    *(.literal._RNvX*NtNtNtCs*_4core4iter8adapters5chainINt*5ChainINtNt*3map3MapINtNt*7flatten7FlattenINtNt*6option8IntoIterRSNtNtCs*_13cranpose_core23snapshot_state_observer13ObservedStateEENCNvM**Nt*11ObservedIds4iter0EINt*7FlatMapI*RINtNtCs*_5alloc5boxed3BoxINtNtNtNtCs*_3std11collections4hash3map7HashMapNtNt*5state8ObjectIdINt*6OptionINtNt*2rc2RcDNtNt*3any3AnyEL_EEINtNt*4hash18BuildHasherDefaultNtNtNt*11collections9word_hash10WordHasherEEEEINtNt*6copied6CopiedINt*4Keys**EENC*s_0EENtNtNt*6traits8iterator8Iterator4next* .text._RNvX*NtNtNtCs*_4core4iter8adapters5chainINt*5ChainINtNt*3map3MapINtNt*7flatten7FlattenINtNt*6option8IntoIterRSNtNtCs*_13cranpose_core23snapshot_state_observer13ObservedStateEENCNvM**Nt*11ObservedIds4iter0EINt*7FlatMapI*RINtNtCs*_5alloc5boxed3BoxINtNtNtNtCs*_3std11collections4hash3map7HashMapNtNt*5state8ObjectIdINt*6OptionINtNt*2rc2RcDNtNt*3any3AnyEL_EEINtNt*4hash18BuildHasherDefaultNtNtNt*11collections9word_hash10WordHasherEEEEINtNt*6copied6CopiedINt*4Keys**EENC*s_0EENtNtNt*6traits8iterator8Iterator4next*)
    *(.literal._RNvX*NvM*NtCs*_13cranpose_core23snapshot_state_observerNt*26SnapshotStateObserverInner13observe_readsNt*22ActiveObservationGuardNtNtNtCs*_4core3ops4drop4Drop4drop* .text._RNvX*NvM*NtCs*_13cranpose_core23snapshot_state_observerNt*26SnapshotStateObserverInner13observe_readsNt*22ActiveObservationGuardNtNtNtCs*_4core3ops4drop4Drop4drop*)
    *(.literal._RNvX*NvM*NtCs*_13cranpose_core8composerNt*8Composer7installNt*5GuardNtNtNtCs*_4core3ops4drop4Drop4drop* .text._RNvX*NvM*NtCs*_13cranpose_core8composerNt*8Composer7installNt*5GuardNtNtNtCs*_4core3ops4drop4Drop4drop*)
    *(.literal._RNvX*NvNtNtCs*_22cranpose_render_pixels8pipeline10draw_child19push_draw_primitiveNt*12SceneEmitterNtNtCs*_22cranpose_render_common14primitive_emit17DrawPrimitiveSink10push_shape* .text._RNvX*NvNtNtCs*_22cranpose_render_pixels8pipeline10draw_child19push_draw_primitiveNt*12SceneEmitterNtNtCs*_22cranpose_render_common14primitive_emit17DrawPrimitiveSink10push_shape*)
    *(.literal._RNvYINtNtCs*_11cranpose_ui11interaction15InteractionNodeNt*12PressTrackerENtNtCs*_19cranpose_foundation8modifier12ModifierNode12as_draw_node* .text._RNvYINtNtCs*_11cranpose_ui11interaction15InteractionNodeNt*12PressTrackerENtNtCs*_19cranpose_foundation8modifier12ModifierNode12as_draw_node*)
    *(.literal._RNvYINtNtCs*_11cranpose_ui11interaction15InteractionNodeNt*12PressTrackerENtNtCs*_19cranpose_foundation8modifier16PointerInputNode16layout_size_sink* .text._RNvYINtNtCs*_11cranpose_ui11interaction15InteractionNodeNt*12PressTrackerENtNtCs*_19cranpose_foundation8modifier16PointerInputNode16layout_size_sink*)
    *(.literal._RNvYINtNtCs*_13cranpose_core18composition_locals16LocalValuePolicyINtNtCs*_4core6option6OptionNtNtNtCs*_11cranpose_ui7widgets17shared_transition11SharedEntryEEINtNt*5state14MutationPolicy*E5merge* .text._RNvYINtNtCs*_13cranpose_core18composition_locals16LocalValuePolicyINtNtCs*_4core6option6OptionNtNtNtCs*_11cranpose_ui7widgets17shared_transition11SharedEntryEEINtNt*5state14MutationPolicy*E5merge*)
    *(.literal._RNvYNCNvX*NtNtCs*_11cranpose_ui6layout23layout_child_measurableNt*21LayoutChildMeasurableNtNtCs*_18cranpose_ui_layout4core10Measurable20max_intrinsic_height0INtNtNtCs*_4core3ops8function6FnOnceTNtNtCs*_20cranpose_ui_graphics8geometry4SizeEE9call_once* .text._RNvYNCNvX*NtNtCs*_11cranpose_ui6layout23layout_child_measurableNt*21LayoutChildMeasurableNtNtCs*_18cranpose_ui_layout4core10Measurable20max_intrinsic_height0INtNtNtCs*_4core3ops8function6FnOnceTNtNtCs*_20cranpose_ui_graphics8geometry4SizeEE9call_once*)
    *(.literal._RNvYNtNtCs*_11cranpose_ui14modifier_nodes10OffsetNodeNtNtCs*_19cranpose_foundation8modifier12ModifierNode21for_each_delegate_mut* .text._RNvYNtNtCs*_11cranpose_ui14modifier_nodes10OffsetNodeNtNtCs*_19cranpose_foundation8modifier12ModifierNode21for_each_delegate_mut*)
    *(.literal._RNvYNtNtCs*_11cranpose_ui14modifier_nodes16SizeReporterNodeNtNtCs*_19cranpose_foundation8modifier18LayoutModifierNode12measure_hold* .text._RNvYNtNtCs*_11cranpose_ui14modifier_nodes16SizeReporterNodeNtNtCs*_19cranpose_foundation8modifier18LayoutModifierNode12measure_hold*)
    *(.literal._RNvYNtNtCs*_11cranpose_ui6layout17LayoutNodeContextNtNtCs*_19cranpose_foundation8modifier19ModifierNodeContext24push_active_capabilities* .text._RNvYNtNtCs*_11cranpose_ui6layout17LayoutNodeContextNtNtCs*_19cranpose_foundation8modifier19ModifierNodeContext24push_active_capabilities*)
    *(.literal._RNvYNtNtCs*_11cranpose_ui6layout17LayoutNodeContextNtNtCs*_19cranpose_foundation8modifier19ModifierNodeContext7node_id* .text._RNvYNtNtCs*_11cranpose_ui6layout17LayoutNodeContextNtNtCs*_19cranpose_foundation8modifier19ModifierNodeContext7node_id*)
    *(.literal._RNvYNtNtCs*_13cranpose_core5state15StructuralEqualINt*14MutationPolicyjE5merge* .text._RNvYNtNtCs*_13cranpose_core5state15StructuralEqualINt*14MutationPolicyjE5merge*)
    *(.literal._RNvYNtNtNtNtCs*_11cranpose_ui7widgets5nodes11layout_node10LayoutNodeNtNtCs*_13cranpose_core4node4Node12layout_dirty* .text._RNvYNtNtNtNtCs*_11cranpose_ui7widgets5nodes11layout_node10LayoutNodeNtNtCs*_13cranpose_core4node4Node12layout_dirty*)
    *(.literal._RNvYNvYNtNtCs*_11cranpose_ui16layout_direction15LayoutDirectionNtNtCs*_4core7default7Default7defaultINtNtNt*3ops8function2FnuE4call* .text._RNvYNvYNtNtCs*_11cranpose_ui16layout_direction15LayoutDirectionNtNtCs*_4core7default7Default7defaultINtNtNt*3ops8function2FnuE4call*)
    *(.literal._RNvYNvYNtNtCs*_11cranpose_ui16layout_direction15LayoutDirectionNtNtCs*_4core7default7Default7defaultINtNtNt*3ops8function5FnMutuE8call_mut* .text._RNvYNvYNtNtCs*_11cranpose_ui16layout_direction15LayoutDirectionNtNtCs*_4core7default7Default7defaultINtNtNt*3ops8function5FnMutuE8call_mut*)
  }
}
INSERT AFTER .iram0.text;
